/*
 * Copyright (C) 2016-2017 F&S Elektronik Systeme GmbH
 *
 * This program is free software; you can redistribute it and/or modify
 * it under the terms of the GNU General Public License version 2 as
 * published by the Free Software Foundation.
 */

/dts-v1/;

/* Set board revision as 3-digit number, e.g. 110 for board rev. 1.10 */
#define CONFIG_PICOMODA9_BOARD_REVISION	110

#define DISPLAY_NONE	0	/* No display on this port */
#define DISPLAY_LCD	1	/* LCD via RGB adapter */
#define DISPLAY_HDMI	2	/* DVI/HDMI via HDMI connector */
#define DISPLAY_LVDS0	3	/* LVDS channel 0 */
#define DISPLAY_BT656	5	/* BT656 via ADV739x */

/*
 * Set the display configuration:
 *
 * Due to hardware limitations you can only use either LCD or HDMI at the
 * same time. Furthermore we only have one LVDS channel. Based on this
 * specifications you can connect at most two displays on PicoMODA9. Either
 * one LVDS and one HDMI display or one LVDS and one LCD display. HDMI also
 * needs an I2C port on pins 42+44, so CAN_B and UART_D_CTS can not be used
 * at the same time.
 *
 * - If you have no display, set both settings to DISPLAY_NONE.
 * - If you have one display, set MXCFB0 to one of the display types above and
 *   leave the other settings at DISPLAY_NONE.
 * - If you have two displays, set both settings to a display type from above.
 *   You have to use different types for the two displays.
 *
 * If you set up two displays they will also get a video overlay, so MXCFB0
 * will use /dev/fb0 and /dev/fb1, MXCFB1 will use /dev/fb2 and /dev/fb3. If
 * you want to restrict the display output to one IPU (i.MX6 Dual/Quad has two
 * IPUs), for example for energy saving reasons, you must set
 * CONFIG_PICOMODA9_USE_ONE_IPU below. Then only MXCFB0 will get a video
 * overlay and uses /dev/fb0 and /dev/fb1, and MXCFB1 will only use /dev/fb2.
 */
#define CONFIG_PICOMODA9_MXCFB0		DISPLAY_LVDS0
#define CONFIG_PICOMODA9_MXCFB1		DISPLAY_NONE

/*
 * Define this if you only want to use one IPU. This means that you can use
 * at most two displays and only the first display can have a video overlay.
 * If you want to have more than two displays or if you want to have two
 * displays with a video overlay each, then you need to use both IPUs of the
 * i.MX6 Dual/Quad CPU.
 */
//#define CONFIG_PICOMODA9_USE_ONE_IPU

/*
 * Configure LCD settings here (ignored if LCD is not used);
 * see drivers/video/fbdev/mxc/mxc_lcdif.c for possible LCD mode strings
 */
#define CONFIG_PICOMODA9_LCD_BPP	32
#define CONFIG_PICOMODA9_LCD_PIX_FMT	"RGB666"
#define CONFIG_PICOMODA9_LCD_MODE_STR	"LCD-ET070080"

/*
 * Configure BT656 settings here (ignored if BT656 is not used);
 * see drivers/video/fbdev/mxc/mxc_bt656.c for possible mode strings
 */
#define CONFIG_PICOMODA9_BT656_BPP	32
#define CONFIG_PICOMODA9_BT656_PIX_FMT	"BT656"
#define CONFIG_PICOMODA9_BT656_MODE_STR	"BT656-PAL"

/* Configure HDMI settings here (ignored if HDMI is not used) */
#define CONFIG_PICOMODA9_HDMI_BPP	32
#define CONFIG_PICOMODA9_HDMI_PIX_FMT	"RGB24"
#define CONFIG_PICOMODA9_HDMI_MODE_STR	"1920x1080M@60"

/*
 * F&S has changed the default LVDS display. To use the previous settings
 * activate the following define.
 */
//#define DISPLAY_LVDS_CHIMEI

/*
 * Configure LVDS0 settings here (ignored if LVDS0 is not used)
 * Mapping (refers to LVDS_DATA_WIDTH, not LVDS_BPP):
 *
 * - "spwg":  18 bpp or 24 bpp, in case of 24 bpp, bits 6 and 7 of each color
 *            are encoded on fourth LVDS differential data pair
 * - "jeida": only 24 bpp, bits 6 and 7 of each color are interleaved with
 *            all other data bits on all four differential data pairs
 */
#ifndef DISPLAY_LVDS_CHIMEI
#define CONFIG_PICOMODA9_LVDS0_BPP		32
#define CONFIG_PICOMODA9_LVDS0_PIX_FMT		"RGB24"
#define CONFIG_PICOMODA9_LVDS0_DATA_WIDTH	24
#define CONFIG_PICOMODA9_LVDS0_MAPPING		"spwg"
#define CONFIG_PICOMODA9_LVDS0_TIMING \
wvga {					\
	clock-frequency = <33500000>;	\
	hactive = <800>;		\
	vactive = <480>;		\
	hfront-porch = <4>;		\
	hback-porch = <44>;		\
	hsync-len = <2>;		\
	vback-porch = <21>;		\
	vfront-porch = <11>;		\
	vsync-len = <2>;		\
	hsync-active = <0>;		\
	vsync-active = <0>;		\
	de-active = <1>;		\
	pixelclk-active = <0>;		\
}
#else
#define CONFIG_PICOMODA9_LVDS0_BPP		32
#define CONFIG_PICOMODA9_LVDS0_PIX_FMT		"RGB666"
#define CONFIG_PICOMODA9_LVDS0_DATA_WIDTH	18
#define CONFIG_PICOMODA9_LVDS0_MAPPING		"spwg"
#define CONFIG_PICOMODA9_LVDS0_TIMING \
wvga {					\
	clock-frequency = <33500000>;	\
	hactive = <800>;		\
	vactive = <480>;		\
	hfront-porch = <40>;		\
	hback-porch = <88>;		\
	hsync-len = <128>;		\
	vback-porch = <33>;		\
	vfront-porch = <10>;		\
	vsync-len = <2>;		\
	hsync-active = <0>;		\
	vsync-active = <0>;		\
	de-active = <1>;		\
	pixelclk-active = <0>;		\
}
#endif

/*
 * Configure touch screen:
 *
 * - 4-wire/5-wire analog resistive touch, touch controller on-board
 * - PCAP touch based on Maxtouch controller (MXT224, etc.), on Touch Connector
 * - PCAP touch based on Focaltech controller (FT5x06), on Touch Connector
 * - PCAP touch based on Sitronix controller (ST1633i), on Touch Connector
 * - PCAP touch based on Ilitek controller (ILI12xx), on Touch Connector
 *
 * On PicoMODA9, all touches use the same interrupt line and I2C bus, so do not
 * select more than one entry! Select none if you do not need touch support.
 */
//#define CONFIG_PICOMODA9_4WTOUCH_SX8655_ONBOARD
//#define CONFIG_PICOMODA9_CAPTOUCH_MXT224
#define CONFIG_PICOMODA9_CAPTOUCH_FT5x06
//#define CONFIG_PICOMODA9_CAPTOUCH_SITRONIX
//#define CONFIG_PICOMODA9_CAPTOUCH_ILITEK

/* CMA: Set 320 MB for Continuous Memory Allocator */
#define CONFIG_PICOMODA9_CMA_SIZE	0x14000000

/* NAND */
#define CONFIG_PICOMODA9_NAND

/* EMMC; optionally available starting with board revision 1.10 */
#define CONFIG_PICOMODA9_EMMC

/* AUDIO */
#define CONFIG_PICOMODA9_SGTL5000_AUDIO

/*
 * Parallel digital camera interface; this is a hardware option since board
 * revision 1.10 where the camera signals replace some LCD signals. So camera
 * can not be used together with LCD, only HDMI. The camera also requires an
 * I2C port on pins 41+43, so CAN_B and UART_D_RTS also can not be used in
 * this case.
 */
//#define CONFIG_PICOMODA9_PARALLEL_CAMERA

/* CAN_A */
#define CONFIG_PICOMODA9_CAN_A

/*
 * CAN_B on pins 41+42; can only be used with Board Revision 1.10 or newer and
 * when none of HDMI, Parallel Camera and RTS/CTS on UART_D is active.
 */ 
//#define CONFIG_PICOMODA9_CAN_B

/*
 * SD_A: On-board Micro-SD card slot, no CD, no WP. Starting with board rev.
 * 1.10, this port is only available if no on-board eMMC is installed.
 */
#define CONFIG_PICOMODA9_SD_A

/* SD_B: ext. SD card slot (on SKIT: normal-sized SD card slot, CD, WP, PWR) */
#define CONFIG_PICOMODA9_SD_B
#define CONFIG_PICOMODA9_SD_B_CD
#define CONFIG_PICOMODA9_SD_B_WP
#define CONFIG_PICOMODA9_SD_B_PWR

/* I2C */
#define CONFIG_PICOMODA9_I2C_A
#define CONFIG_PICOMODA9_I2C_B
#define CONFIG_PICOMODA9_I2C_C

/* SPI */
#define CONFIG_PICOMODA9_SPI_A

/* UART */
#define CONFIG_PICOMODA9_UART_A
#define CONFIG_PICOMODA9_UART_B
#define CONFIG_PICOMODA9_UART_C

/*
 * UART_D is optional and needs hardware modifications. You can either have
 * UART_D instead of UART_A_RTS/CTS on pins 19+20 or instead of CAN_A on pins
 * 5+6. If board revision is at least 1.10 and you also do not need CAN_B,
 * HDMI and Camera, then UART_D can even have RTS/CTS on pins 41+42. If you
 * just need RTS (e.g. for RS485), then HDMI in parallel is still OK.
 */
#define CONFIG_PICOMODA9_UART_A_RTSCTS
//#define CONFIG_PICOMODA9_UART_D
//#define CONFIG_PICOMODA9_UART_D_RS485
//#define CONFIG_PICOMODA9_UART_D_RTSCTS

#include "imx6q.dtsi"
#include "picomoda9qdl.dtsi"

/ {
	model = "F&S i.MX6 Dual/Quad PicoMODA9 module";
	compatible = "fsl,imx6q-picomoda9", "fsl,imx6q";
};

&bdinfo {
	board_name = "picomoda9q";
};
