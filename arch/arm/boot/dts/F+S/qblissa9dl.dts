/*
 * Copyright (C) 2016-2017 F&S Elektronik Systeme GmbH
 *
 * This program is free software; you can redistribute it and/or modify
 * it under the terms of the GNU General Public License version 2 as
 * published by the Free Software Foundation.
 */

/dts-v1/;

/* Set board revision as 3-digit number, e.g. 100 for board rev. 1.00 */
#define CONFIG_QBLISSA9_BOARD_REVISION	131

#define DISPLAY_NONE	0	/* No display on this port */
#define DISPLAY_LCD	1	/* LCD via RGB adapter */
#define DISPLAY_HDMI	2	/* DVI/HDMI via HDMI connector */
#define DISPLAY_LVDS0	3	/* LVDS channel 0 */
#define DISPLAY_LVDS1	4	/* LVDS channel 1 */

/*
 * Set the display configuration:
 *
 * - If you have no display, set both settings to DISPLAY_NONE.
 * - If you have one display, set MXCFB0 to one of the display types above
 *   and leave MXCFB1 at DISPLAY_NONE.
 * - If you have two displays, set both settings to a display type from above.
 *   You have to use different types for the two displays.
 *
 * The first display will also get a video overlay, so MXCFB0 will use /dev/fb0
 * and /dev/fb1 and MXCFB1 will use /dev/fb2.
 */
#define CONFIG_QBLISSA9_MXCFB0	DISPLAY_LVDS0
#define CONFIG_QBLISSA9_MXCFB1	DISPLAY_NONE

/* i.MX6 Solo and DualLite only have one IPU, do not change */
#define CONFIG_QBLISSA9_USE_ONE_IPU

/*
 * Configure HDMI settings here (ignored if HDMI is not used).
 *
 * Remark:
 * On the F&S SKIT baseboard, pixel format RGB24 is correct. However due to a
 * hardware bug on QBlissA9, pixel format BGR24 is needed to make HDMI work on
 * a standard Qseven baseboard (in DVI mode). Please change if required.
 */
#define CONFIG_QBLISSA9_HDMI_BPP	32
#define CONFIG_QBLISSA9_HDMI_PIX_FMT	"RGB24"
//#define CONFIG_QBLISSA9_HDMI_PIX_FMT	"BGR24"
#define CONFIG_QBLISSA9_HDMI_MODE_STR	"1920x1080M@60"

/*
 * F&S has changed the default LVDS display. To use the previous settings
 * activate the following define.
 */
//#define DISPLAY_LVDS_CHIMEI

/*
 * Configure LVDS0 settings here (ignored if LVDS0 is not used)
 * Mapping (refers to LVDS_DATA_WIDTH, not LVDS_BPP):
 *
 * - "spwg":  18 bpp or 24 bpp, in case of 24 bpp, bits 6 and 7 of each color
 *            are encoded on fourth LVDS differential data pair
 * - "jeida": only 24 bpp, bits 6 and 7 of each color are interleaved with
 *            all other data bits on all four differential data pairs
 */
#ifndef DISPLAY_LVDS_CHIMEI
#define CONFIG_QBLISSA9_LVDS0_BPP	32
#define CONFIG_QBLISSA9_LVDS0_PIX_FMT	"RGB24"
#define CONFIG_QBLISSA9_LVDS0_DATA_WIDTH	24
#define CONFIG_QBLISSA9_LVDS0_MAPPING	"spwg"
#define CONFIG_QBLISSA9_LVDS0_TIMING \
wvga {					\
	clock-frequency = <33300000>;	\
	hactive = <800>;		\
	vactive = <480>;		\
	hfront-porch = <210>;		\
	hback-porch = <45>;		\
	hsync-len = <1>;		\
	vback-porch = <22>;		\
	vfront-porch = <22>;		\
	vsync-len = <1>;		\
	hsync-active = <0>;		\
	vsync-active = <0>;		\
	de-active = <1>;		\
	pixelclk-active = <0>;		\
}
#else
#define CONFIG_QBLISSA9_LVDS0_BPP	32
#define CONFIG_QBLISSA9_LVDS0_PIX_FMT	"RGB666"
#define CONFIG_QBLISSA9_LVDS0_DATA_WIDTH	18
#define CONFIG_QBLISSA9_LVDS0_MAPPING	"spwg"
#define CONFIG_QBLISSA9_LVDS0_TIMING \
wvga {					\
	clock-frequency = <33500000>;	\
	hactive = <800>;		\
	vactive = <480>;		\
	hfront-porch = <40>;		\
	hback-porch = <88>;		\
	hsync-len = <128>;		\
	vback-porch = <33>;		\
	vfront-porch = <10>;		\
	vsync-len = <2>;		\
	hsync-active = <0>;		\
	vsync-active = <0>;		\
	de-active = <1>;		\
	pixelclk-active = <0>;		\
}
#endif

/*
 * Configure LVDS1 settings here (ignored if LVDS1 is not used)
 * For mapping value see above.
 */
#ifndef DISPLAY_LVDS_CHIMEI
#define CONFIG_QBLISSA9_LVDS1_BPP	32
#define CONFIG_QBLISSA9_LVDS1_PIX_FMT	"RGB24"
#define CONFIG_QBLISSA9_LVDS1_DATA_WIDTH	24
#define CONFIG_QBLISSA9_LVDS1_MAPPING	"spwg"
#define CONFIG_QBLISSA9_LVDS1_TIMING \
wvga {					\
	clock-frequency = <33300000>;	\
	hactive = <800>;		\
	vactive = <480>;		\
	hfront-porch = <210>;		\
	hback-porch = <45>;		\
	hsync-len = <1>;		\
	vback-porch = <22>;		\
	vfront-porch = <22>;		\
	vsync-len = <1>;		\
	hsync-active = <0>;		\
	vsync-active = <0>;		\
	de-active = <1>;		\
	pixelclk-active = <0>;		\
}
#else
#define CONFIG_QBLISSA9_LVDS1_BPP	32
#define CONFIG_QBLISSA9_LVDS1_PIX_FMT	"RGB666"
#define CONFIG_QBLISSA9_LVDS1_DATA_WIDTH	18
#define CONFIG_QBLISSA9_LVDS1_MAPPING	"spwg"
#define CONFIG_QBLISSA9_LVDS1_TIMING \
wvga {					\
	clock-frequency = <33500000>;	\
	hactive = <800>;		\
	vactive = <480>;		\
	hfront-porch = <40>;		\
	hback-porch = <88>;		\
	hsync-len = <128>;		\
	vback-porch = <33>;		\
	vfront-porch = <10>;		\
	vsync-len = <2>;		\
	hsync-active = <0>;		\
	vsync-active = <0>;		\
	de-active = <1>;		\
	pixelclk-active = <0>;		\
}
#endif

/*
 * Depending on the needed pixel clock speed, the LVDS clock source must be
 * selected accordingly. If pixelclock is between 38.7 MHz and 113 MHz,
 * PLL2_PFD0 is sufficient. Otherwise PLL5 has to be used. If you have two
 * LVDS displays with different clock requirements, set one to PLL2_PFD0 and the
 * other to PLL5. If you have activated the displays in U-Boot already and want
 * to keep these settings in Linux, de-activate all four lines.
 */
//#define CONFIG_QBLISSA9_LVDS0_CLK  IMX6QDL_CLK_PLL2_PFD0_352M
#define CONFIG_QBLISSA9_LVDS0_CLK  IMX6QDL_CLK_PLL5_VIDEO_DIV
//#define CONFIG_QBLISSA9_LVDS1_CLK  IMX6QDL_CLK_PLL2_PFD0_352M
#define CONFIG_QBLISSA9_LVDS1_CLK  IMX6QDL_CLK_PLL5_VIDEO_DIV

/*
 * Define this for a two-channel display, i.e. one display, one framebuffer,
 * but two LVDS channels, even pixels from one channel, odd pixels from the
 * other channel. Only define either DISPLAY_LVDS0 or DISPLAY_LVDS1 in this
 * case, using the full display resolution.
 */
//#define CONFIG_QBLISSA9_LVDS_SPLIT_MODE

/*
 * Define this if you have two similar displays (same resolution and timings),
 * one on each LVDS channel. The display content of the framebuffer is shown
 * on both displays simultaneously (cloned). Only define either DISPLAY_LVDS0
 * or DISPLAY_LVDS1 in this case, using the resolution of one of the displays.
 */
//#define CONFIG_QBLISSA9_LVDS_DUAL_MODE

/*
 * Configure touch screen:
 *
 * - 4-wire analog resisitive touch (WM9715), on AC97 port
 * - 4-wire/5-wire analog resistive touch (SX8655), on SMB/I2C port
 * - PCAP touch based on Maxtouch controller (MXT224, etc.), on SMB/I2C port
 * - PCAP touch based on Focaltech controller (FT5x06), on SMB/I2C port
 * - PCAP touch based on Sitronix controller (ST1633i), on SMB/I2C port
 * - PCAP touch based on Ilitek controller (ILI12xx), on SMB/I2C port
 *
 * Select none if you do not need touch support.
 */
//#define CONFIG_QBLISSA9_4WTOUCH_SX8655
//#define CONFIG_QBLISSA9_4WTOUCH_TSC2004
//#define CONFIG_QBLISSA9_CAPTOUCH_MXT224
#define CONFIG_QBLISSA9_CAPTOUCH_FT5x06
//#define CONFIG_QBLISSA9_CAPTOUCH_SITRONIX
//#define CONFIG_QBLISSA9_CAPTOUCH_ILITEK

/* CMA: Set 320 MB for Continuous Memory Allocator */
#define CONFIG_QBLISSA9_CMA_SIZE	0x14000000

/* Camera on parallel CSI interface */
#define CONFIG_QBLISSA9_PARALLEL_CAMERA

/* NAND */
#define CONFIG_QBLISSA9_NAND

/* Set if USB OTG has over-current detection on OC pin */
#define CONFIG_QBLISSA9_HAVE_USB_OTG_OC

/* Set if USB OTG should run in host mode */
//#define CONFIG_QBLISSA9_USB_OTG_HOST

/* AUDIO */
#define CONFIG_QBLISSA9_WM9715_AUDIO

/* WLAN/BLUETOOTH */
//#define CONFIG_QBLISSA9_WLAN
//#define CONFIG_QBLISSA9_BLUETOOTH

/* SD_A - On SKIT: Micro-SD Card Slot, CD always low, WP unused, 4 bit */
#define CONFIG_QBLISSA9_SD_A
//#define CONFIG_QBLISSA9_SD_A_CD
//#define CONFIG_QBLISSA9_SD_A_WP
//#define CONFIG_QBLISSA9_SD_A_8BIT

/* PCIe */
//#define CONFIG_QBLISSA9_PCIE

/* I2C_A: SDA/SCL on pins 68/66 (this is also on pins 126/128!) */
#define CONFIG_QBLISSA9_I2C_A

/* I2C_B: SDA/SCL/IRQ on pins 62/60/64 (SMB) */
#define CONFIG_QBLISSA9_I2C_B

/* I2C_C: SDA/SCL on pins 125/127 (instead of LVDS_DID) */
#define CONFIG_QBLISSA9_I2C_C

/* I2C_D SDA/SCL only on module */
#define CONFIG_QBLISSA9_I2C_D

/*
 * UART_A: TXD/RXD on 171/177, RTS/CTS on pins 172/178 (also TXD/RDX on pins
 * 163/161, RTS/CTS on pins 164/162; this is a hardware option)
 */
#define CONFIG_QBLISSA9_UART_A

/* UART_B: TXD/RXD on pins 209/208, no RTS/CTS */
#define CONFIG_QBLISSA9_UART_B

/* UART_C: TXD/RXD on pins 186/185, RTS/CTS on pins 188/187 */
#define CONFIG_QBLISSA9_UART_C

/* SPI */
#define CONFIG_QBLISSA9_SPI_A
//#define CONFIG_QBLISSA9_SPI_FLASH

/* PWM_A/LVDS_BLT_CTRL on pin 123 */
#define CONFIG_QBLISSA9_PWM_A

/* PWM_B/FAN_PWMOUT on pin 196 */
#define CONFIG_QBLISSA9_PWM_B

/* PWM_C/SPKR on pin 194 */
#define CONFIG_QBLISSA9_PWM_C

#include "imx6dl.dtsi"
#include "qblissa9qdl.dtsi"

/ {
	model = "F&S i.MX6 Dual/Quad QBlissA9";
	compatible = "fsl,imx6dl-qblissa9", "fsl,imx6dl";
};

&bdinfo {
	board_name = "qblissa9dl";
};

/* i.MX6 Solo and DualLite have a PXP engine */
&pxp {
	status = "okay";
};
