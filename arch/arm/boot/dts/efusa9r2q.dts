/*
 * Copyright (C) 2022 F&S Elektronik Systeme GmbH
 *
 * This program is free software; you can redistribute it and/or modify
 * it under the terms of the GNU General Public License version 2 as
 * published by the Free Software Foundation.
 */

/dts-v1/;

/* Set board revision as 3-digit number, e.g. 110 for board rev. 1.10 */
#define CONFIG_EFUSA9R2_BOARD_REVISION	110

#define DISPLAY_NONE	0	/* No display on this port */
#define DISPLAY_LCD	1	/* LCD via RGB adapter */
#define DISPLAY_HDMI	2	/* DVI/HDMI via HDMI connector */
#define DISPLAY_LVDS0	3	/* LVDS channel 0 */
#define DISPLAY_LVDS1	4	/* LVDS channel 1 */
#define DISPLAY_BT656	5	/* BT656 via ADV739x */

/*
 * Set the display configuration:
 *
 * - If you have no display, set all four settings to DISPLAY_NONE.
 * - If you have one display, set MXCFB0 to one of the display types above and
 *   leave the other settings at DISPLAY_NONE.
 * - If you have two displays, set MXCFB0 and MXCFB1 to a display type from
 *   above and leave the other two at DISPLAY_NONE.
 * - If you have three displays, set MXCFB0, MXCFB1 and MXCFB2 to a display
 *   type from above and leave MXCFB3 at DISPLAY_NONE.
 * - If you have four displays, set all four settings to a valid display type.
 *
 * You have to use a different type for each display. If you want two LVDS
 * displays, set one to DISPLAY_LVDS0 and the other to DISPLAY_LVDS1. This
 * corresponds to the LVDS channel where the display is connected to.
 *
 * The first two displays will also get a video overlay, so MXCFB0 will use
 * /dev/fb0 and /dev/fb1, MXCFB1 will use /dev/fb2 and /dev/fb3, MXCFB2 will
 * use /dev/fb4 and MXCFB3 will use /dev/fb5. If you want to restrict the
 * display output to one IPU (i.MX6 Dual/Quad has two IPUs), for example for
 * energy saving reasons, you must not use more than two displays and you must
 * set CONFIG_EFUSA9R2_USE_ONE_IPU below. Then only MXCFB0 will get a video
 * overlay and uses /dev/fb0 and /dev/fb1, and MXCFB1 will only use /dev/fb2.
 */
#define CONFIG_EFUSA9R2_MXCFB0		DISPLAY_LCD
#define CONFIG_EFUSA9R2_MXCFB1		DISPLAY_NONE
#define CONFIG_EFUSA9R2_MXCFB2		DISPLAY_NONE
#define CONFIG_EFUSA9R2_MXCFB3		DISPLAY_NONE

/*
 * Define this if you only want to use one IPU. This means that you can use
 * at most two displays and only the first display can have a video overlay.
 * If you want to have more than two displays or if you want to have two
 * displays with a video overlay each, then you need to use both IPUs of the
 * i.MX6 Dual/Quad CPU.
 */
//#define CONFIG_EFUSA9R2_USE_ONE_IPU

/*
 * Configure LCD settings here (ignored if LCD is not used);
 * see drivers/video/fbdev/mxc/mxc_lcdif.c for possible LCD mode strings
 */
#define CONFIG_EFUSA9R2_LCD_BPP		32
#define CONFIG_EFUSA9R2_LCD_PIX_FMT	"BGR666"
#define CONFIG_EFUSA9R2_LCD_MODE_STR	"LCD-ET070080"

/*
 * Configure BT656 settings here (ignored if BT656 is not used);
 * see drivers/video/fbdev/mxc/mxc_bt656.c for possible mode strings
 */
#define CONFIG_EFUSA9R2_BT656_BPP		32
#define CONFIG_EFUSA9R2_BT656_PIX_FMT	"BT656"
#define CONFIG_EFUSA9R2_BT656_MODE_STR	"BT656-PAL"

/* Configure HDMI settings here (ignored if HDMI is not used) */
#define CONFIG_EFUSA9R2_HDMI_BPP		32
#define CONFIG_EFUSA9R2_HDMI_PIX_FMT	"RGB24"
#define CONFIG_EFUSA9R2_HDMI_MODE_STR	"1920x1080M@60"

/*
 * F&S has changed the default LVDS display. To use the previous settings
 * activate the following define.
 */
//#define DISPLAY_LVDS_CHIMEI

/*
 * Configure LVDS0 settings here (ignored if LVDS0 is not used)
 * Mapping (refers to LVDS_DATA_WIDTH, not LVDS_BPP):
 *
 * - "spwg":  18 bpp or 24 bpp, in case of 24 bpp, bits 6 and 7 of each color
 *            are encoded on fourth LVDS differential data pair
 * - "jeida": only 24 bpp, bits 6 and 7 of each color are interleaved with
 *            all other data bits on all four differential data pairs
 */
#ifndef DISPLAY_LVDS_CHIMEI
#define CONFIG_EFUSA9R2_LVDS0_BPP		32
#define CONFIG_EFUSA9R2_LVDS0_PIX_FMT	"RGB24"
#define CONFIG_EFUSA9R2_LVDS0_DATA_WIDTH	24
#define CONFIG_EFUSA9R2_LVDS0_MAPPING	"spwg"
#define CONFIG_EFUSA9R2_LVDS0_TIMING \
wvga {					\
	clock-frequency = <33500000>;	\
	hactive = <800>;		\
	vactive = <480>;		\
	hfront-porch = <4>;		\
	hback-porch = <44>;		\
	hsync-len = <2>;		\
	vback-porch = <21>;		\
	vfront-porch = <11>;		\
	vsync-len = <2>;		\
	hsync-active = <0>;		\
	vsync-active = <0>;		\
	de-active = <1>;		\
	pixelclk-active = <0>;		\
}
#else
#define CONFIG_EFUSA9R2_LVDS0_BPP		32
#define CONFIG_EFUSA9R2_LVDS0_PIX_FMT	"RGB666"
#define CONFIG_EFUSA9R2_LVDS0_DATA_WIDTH	18
#define CONFIG_EFUSA9R2_LVDS0_MAPPING	"spwg"
#define CONFIG_EFUSA9R2_LVDS0_TIMING \
wvga {					\
	clock-frequency = <33500000>;	\
	hactive = <800>;		\
	vactive = <480>;		\
	hfront-porch = <40>;		\
	hback-porch = <88>;		\
	hsync-len = <128>;		\
	vback-porch = <33>;		\
	vfront-porch = <10>;		\
	vsync-len = <2>;		\
	hsync-active = <0>;		\
	vsync-active = <0>;		\
	de-active = <1>;		\
	pixelclk-active = <0>;		\
}
#endif

/*
 * Configure LVDS1 settings here (ignored if LVDS1 is not used)
 * For mapping value see above.
 */
#ifndef DISPLAY_LVDS_CHIMEI
#define CONFIG_EFUSA9R2_LVDS1_BPP		32
#define CONFIG_EFUSA9R2_LVDS1_PIX_FMT	"RGB24"
#define CONFIG_EFUSA9R2_LVDS1_DATA_WIDTH	24
#define CONFIG_EFUSA9R2_LVDS1_MAPPING	"spwg"
#define CONFIG_EFUSA9R2_LVDS1_TIMING \
wvga {					\
	clock-frequency = <33500000>;	\
	hactive = <800>;		\
	vactive = <480>;		\
	hfront-porch = <4>;		\
	hback-porch = <44>;		\
	hsync-len = <2>;		\
	vback-porch = <21>;		\
	vfront-porch = <11>;		\
	vsync-len = <2>;		\
	hsync-active = <0>;		\
	vsync-active = <0>;		\
	de-active = <1>;		\
	pixelclk-active = <0>;		\
}
#else
#define CONFIG_EFUSA9R2_LVDS1_BPP		32
#define CONFIG_EFUSA9R2_LVDS1_PIX_FMT	"RGB666"
#define CONFIG_EFUSA9R2_LVDS1_DATA_WIDTH	18
#define CONFIG_EFUSA9R2_LVDS1_MAPPING	"spwg"
#define CONFIG_EFUSA9R2_LVDS1_TIMING \
wvga {					\
	clock-frequency = <33500000>;	\
	hactive = <800>;		\
	vactive = <480>;		\
	hfront-porch = <40>;		\
	hback-porch = <88>;		\
	hsync-len = <128>;		\
	vback-porch = <33>;		\
	vfront-porch = <10>;		\
	vsync-len = <2>;		\
	hsync-active = <0>;		\
	vsync-active = <0>;		\
	de-active = <1>;		\
	pixelclk-active = <0>;		\
}
#endif

/*
 * Depending on the needed pixel clock speed, the LVDS clock source must be
 * selected accordingly. If pixelclock is between 38.7 MHz and 113 MHz,
 * PLL2_PFD0 is sufficient. Otherwise PLL5 has to be used. If you have two
 * LVDS displays with different clock requirements, set one to PLL2_PFD0 and the
 * other to PLL5. If you have activated the displays in U-Boot already and want
 * to keep these settings in Linux, de-activate all four lines.
 */
//#define CONFIG_EFUSA9R2_LVDS0_CLK  IMX6QDL_CLK_PLL2_PFD0_352M
#define CONFIG_EFUSA9R2_LVDS0_CLK  IMX6QDL_CLK_PLL5_VIDEO_DIV
//#define CONFIG_EFUSA9R2_LVDS1_CLK  IMX6QDL_CLK_PLL2_PFD0_352M
#define CONFIG_EFUSA9R2_LVDS1_CLK  IMX6QDL_CLK_PLL5_VIDEO_DIV

/*
 * Define this for a two-channel display, i.e. one display, one framebuffer,
 * but two LVDS channels, even pixels from one channel, odd pixels from the
 * other channel. Only define either DISPLAY_LVDS0 or DISPLAY_LVDS1 in this
 * case, using the full display resolution.
 */
//#define CONFIG_EFUSA9R2_LVDS_SPLIT_MODE

/*
 * Define this if you have two similar displays (same resolution and timings),
 * one on each LVDS channel. The display content of the framebuffer is shown
 * on both displays simultaneously (cloned). Only define either DISPLAY_LVDS0
 * or DISPLAY_LVDS1 in this case, using the resolution of one of the displays.
 */
//#define CONFIG_EFUSA9R2_LVDS_DUAL_MODE

/*
 * Define this if your LVDS display requires 5V I/O logic voltage. Default is
 * 3.3V. ATTENTION: Setting 5V on a 3.3V display may damage the display!
 * Remark: This setting requires board revision 1.21 or newer; older board
 * revisions only support 3.3V.
 */
//#define CONFIG_EFUSA9R2_5V_LVDS

/*
 * Configure touch screen:
 *
 * - 4-wire/5-wire analog resistive touch, touch controller on SKIT
 * - 4-wire/5-wire analog resistive touch, touch controller on RGB LCD adapter
 * - PCAP touch based on Maxtouch controller (MXT224, etc.), on Touch Connector
 * - PCAP touch based on Focaltech controller (FT5x06), on Touch Connector
 * - PCAP touch based on Sitronix controller (ST1633i), on Touch Connector
 * - PCAP touch based on Ilitek controller (ILI12xx), on Touch Connector
 *
 * On efusA9r2, all touches use the same interrupt line and I2C bus, so do not
 * select more than one entry! Select none if you do not need touch support.
 */
//#define CONFIG_EFUSA9R2_4WTOUCH_SX8655_ONBOARD
#define CONFIG_EFUSA9R2_4WTOUCH_SX8655_RGBADAPTER
//#define CONFIG_EFUSA9R2_4WTOUCH_TSC2004_RGBADAPTER
//#define CONFIG_EFUSA9R2_CAPTOUCH_MXT224
//#define CONFIG_EFUSA9R2_CAPTOUCH_FT5x06
//#define CONFIG_EFUSA9R2_CAPTOUCH_SITRONIX
//#define CONFIG_EFUSA9R2_CAPTOUCH_ILITEK

/* CMA: Set 320 MB for Continuous Memory Allocator */
#define CONFIG_EFUSA9R2_CMA_SIZE		0x14000000

/* NAND */
#define CONFIG_EFUSA9R2_NAND

/* USB OTG has over-current detection on OC pin */
#define CONFIG_EFUSA9R2_HAVE_USB_OTG_OC

/* AUDIO */
#define CONFIG_EFUSA9R2_SGTL5000_AUDIO

/* Camera connected */
#define CONFIG_EFUSA9R2_CAMERA

/* Camera on parallel CSI interface */
//#define CONFIG_EFUSA9R2_PARALLEL_CAMERA

/* Camera on serial MIPI CSI interface */
#define CONFIG_EFUSA9R2_SERIAL_CAMERA

/* In case of MIPI, select one of the following cameras */
//#define CONFIG_EFUSA9R2_MIPI_CAMERA_OV564X
#define CONFIG_EFUSA9R2_MIPI_CAMERA_ISL7998X

/*
 * SD_A - External SD port with Card Detect (CD) and Write Protect (WP)
 * On efus SKIT: external port is Micro SD card slot with CD but without WP
 */
#define CONFIG_EFUSA9R2_SD_A
#define CONFIG_EFUSA9R2_SD_A_CD
//#define CONFIG_EFUSA9R2_SD_A_WP

/*
 * SD_B - External SD port with Card Detect (CD) and Write Protect (WP)
 * On efus SKIT: external port is normal-sized SD card slot with CD and WP
 */
#define CONFIG_EFUSA9R2_SD_B
#define CONFIG_EFUSA9R2_SD_B_CD
#define CONFIG_EFUSA9R2_SD_B_WP

/* SATA */
#define CONFIG_EFUSA9R2_SATA

/* EMMC */
#define CONFIG_EFUSA9R2_EMMC

/* PCIe */
//#define CONFIG_EFUSA9R2_PCIE

/* I2C */
#define CONFIG_EFUSA9R2_I2C_A
#define CONFIG_EFUSA9R2_I2C_B
#define CONFIG_EFUSA9R2_I2C_C

/* SPI */
#define CONFIG_EFUSA9R2_SPI_A
#define CONFIG_EFUSA9R2_SPI_B

/* UART */
#define CONFIG_EFUSA9R2_UART_A
#define CONFIG_EFUSA9R2_UART_B
#define CONFIG_EFUSA9R2_UART_B_RTSCTS
#define CONFIG_EFUSA9R2_UART_C
#define CONFIG_EFUSA9R2_UART_C_RTSCTS
#define CONFIG_EFUSA9R2_UART_D


#include "imx6q.dtsi"
#include "efusa9r2qdl.dtsi"

/ {
	model = "F&S i.MX6 Dual/Quad efusA9r2 module";
	compatible = "fus,imx6q-efusa9r2", "fsl,imx6q";
};

&bdinfo {
	board_name = "efusa9qr2";
};

/* i.MX6 Dual and Quad can have SATA */
#ifdef CONFIG_EFUSA9R2_SATA
&sata{
	status = "okay";
};
#endif
