/*
 * Copyright (C) 2016-2017 F&S Elektronik Systeme GmbH
 *
 * This program is free software; you can redistribute it and/or modify
 * it under the terms of the GNU General Public License version 2 as
 * published by the Free Software Foundation.
 */

/dts-v1/;

/* Set board revision as 3-digit number, e.g. 110 for board rev. 1.10 */
#define CONFIG_ARMSTONEA9_BOARD_REVISION	110

#define DISPLAY_NONE	0	/* No display on this port */
#define DISPLAY_LCD	1	/* LCD via RGB adapter */
#define DISPLAY_HDMI	2	/* DVI/HDMI via HDMI connector */
#define DISPLAY_LVDS0	3	/* LVDS channel 0 */
#define DISPLAY_LVDS1	4	/* LVDS channel 1 */
#define DISPLAY_BT656	5	/* BT656 via ADV739x */

/*
 * Set the display configuration:
 *
 * - If you have no display, set both settings to DISPLAY_NONE.
 * - If you have one display, set MXCFB0 to one of the display types above
 *   and leave MXCFB1 at DISPLAY_NONE.
 * - If you have two displays, set both settings to a display type from above.
 *   You have to use different types for the two displays.
 *
 * The first display will also get a video overlay, so MXCFB0 will use /dev/fb0
 * and /dev/fb1 and MXCFB1 will use /dev/fb2.
 */
#define CONFIG_ARMSTONEA9_MXCFB0	DISPLAY_LCD
#define CONFIG_ARMSTONEA9_MXCFB1	DISPLAY_NONE

/* i.MX6 Solo and DualLite only have one IPU, do not change */
#define CONFIG_ARMSTONEA9_USE_ONE_IPU

/*
 * Configure LCD settings here (ignored if LCD is not used);
 * see drivers/video/fbdev/mxc/mxc_lcdif.c for possible LCD mode strings
 */
#define CONFIG_ARMSTONEA9_LCD_BPP	32
#define CONFIG_ARMSTONEA9_LCD_PIX_FMT	"RGB666"
#define CONFIG_ARMSTONEA9_LCD_MODE_STR	"LCD-ET070080"

/*
 * Configure BT656 settings here (ignored if BT656 is not used);
 * see drivers/video/fbdev/mxc/mxc_bt656.c for possible mode strings
 */
#define CONFIG_ARMSTONEA9_BT656_BPP	32
#define CONFIG_ARMSTONEA9_BT656_PIX_FMT	"BT656"
#define CONFIG_ARMSTONEA9_BT656_MODE_STR	"BT656-PAL"

/* Configure HDMI settings here (ignored if HDMI is not used) */
#define CONFIG_ARMSTONEA9_HDMI_BPP	32
#define CONFIG_ARMSTONEA9_HDMI_PIX_FMT	"RGB24"
#define CONFIG_ARMSTONEA9_HDMI_MODE_STR	"1920x1080M@60"

/*
 * F&S has changed the default LVDS display. To use the previous settings
 * activate the following define.
 */
//#define DISPLAY_LVDS_CHIMEI

/*
 * Configure LVDS0 settings here (ignored if LVDS0 is not used)
 * Mapping (refers to LVDS_DATA_WIDTH, not LVDS_BPP):
 *
 * - "spwg":  18 bpp or 24 bpp, in case of 24 bpp, bits 6 and 7 of each color
 *            are encoded on fourth LVDS differential data pair
 * - "jeida": only 24 bpp, bits 6 and 7 of each color are interleaved with
 *            all other data bits on all four differential data pairs
 */
#ifndef DISPLAY_LVDS_CHIMEI
#define CONFIG_ARMSTONEA9_LVDS0_BPP	32
#define CONFIG_ARMSTONEA9_LVDS0_PIX_FMT	"RGB24"
#define CONFIG_ARMSTONEA9_LVDS0_DATA_WIDTH	24
#define CONFIG_ARMSTONEA9_LVDS0_MAPPING	"spwg"
#define CONFIG_ARMSTONEA9_LVDS0_TIMING \
wvga {					\
	clock-frequency = <33300000>;	\
	hactive = <800>;		\
	vactive = <480>;		\
	hfront-porch = <210>;		\
	hback-porch = <45>;		\
	hsync-len = <1>;		\
	vback-porch = <22>;		\
	vfront-porch = <22>;		\
	vsync-len = <1>;		\
	hsync-active = <0>;		\
	vsync-active = <0>;		\
	de-active = <1>;		\
	pixelclk-active = <0>;		\
}
#else
#define CONFIG_ARMSTONEA9_LVDS0_BPP	32
#define CONFIG_ARMSTONEA9_LVDS0_PIX_FMT	"RGB666"
#define CONFIG_ARMSTONEA9_LVDS0_DATA_WIDTH	18
#define CONFIG_ARMSTONEA9_LVDS0_MAPPING	"spwg"
#define CONFIG_ARMSTONEA9_LVDS0_TIMING \
wvga {					\
	clock-frequency = <33500000>;	\
	hactive = <800>;		\
	vactive = <480>;		\
	hfront-porch = <40>;		\
	hback-porch = <88>;		\
	hsync-len = <128>;		\
	vback-porch = <33>;		\
	vfront-porch = <10>;		\
	vsync-len = <2>;		\
	hsync-active = <0>;		\
	vsync-active = <0>;		\
	de-active = <1>;		\
	pixelclk-active = <0>;		\
}
#endif

/*
 * Configure LVDS1 settings here (ignored if LVDS1 is not used)
 * For mapping value see above.
 */
#ifndef DISPLAY_LVDS_CHIMEI
#define CONFIG_ARMSTONEA9_LVDS1_BPP	32
#define CONFIG_ARMSTONEA9_LVDS1_PIX_FMT	"RGB24"
#define CONFIG_ARMSTONEA9_LVDS1_DATA_WIDTH	24
#define CONFIG_ARMSTONEA9_LVDS1_MAPPING	"spwg"
#define CONFIG_ARMSTONEA9_LVDS1_TIMING \
wvga {					\
	clock-frequency = <33300000>;	\
	hactive = <800>;		\
	vactive = <480>;		\
	hfront-porch = <210>;		\
	hback-porch = <45>;		\
	hsync-len = <1>;		\
	vback-porch = <22>;		\
	vfront-porch = <22>;		\
	vsync-len = <1>;		\
	hsync-active = <0>;		\
	vsync-active = <0>;		\
	de-active = <1>;		\
	pixelclk-active = <0>;		\
}
#else
#define CONFIG_ARMSTONEA9_LVDS1_BPP	32
#define CONFIG_ARMSTONEA9_LVDS1_PIX_FMT	"RGB666"
#define CONFIG_ARMSTONEA9_LVDS1_DATA_WIDTH	18
#define CONFIG_ARMSTONEA9_LVDS1_MAPPING	"spwg"
#define CONFIG_ARMSTONEA9_LVDS1_TIMING \
wvga {					\
	clock-frequency = <33500000>;	\
	hactive = <800>;		\
	vactive = <480>;		\
	hfront-porch = <40>;		\
	hback-porch = <88>;		\
	hsync-len = <128>;		\
	vback-porch = <33>;		\
	vfront-porch = <10>;		\
	vsync-len = <2>;		\
	hsync-active = <0>;		\
	vsync-active = <0>;		\
	de-active = <1>;		\
	pixelclk-active = <0>;		\
}
#endif

/*
 * Depending on the needed pixel clock speed, the LVDS clock source must be
 * selected accordingly. If pixelclock is between 38.7 MHz and 113 MHz,
 * PLL2_PFD0 is sufficient. Otherwise PLL5 has to be used. If you have two
 * LVDS displays with different clock requirements, set one to PLL2_PFD0 and the
 * other to PLL5. If you have activated the displays in U-Boot already and want
 * to keep these settings in Linux, de-activate all four lines.
 */
//#define CONFIG_ARMSTONEA9_LVDS0_CLK  IMX6QDL_CLK_PLL2_PFD0_352M
#define CONFIG_ARMSTONEA9_LVDS0_CLK  IMX6QDL_CLK_PLL5_VIDEO_DIV
//#define CONFIG_ARMSTONEA9_LVDS1_CLK  IMX6QDL_CLK_PLL2_PFD0_352M
#define CONFIG_ARMSTONEA9_LVDS1_CLK  IMX6QDL_CLK_PLL5_VIDEO_DIV

/*
 * Define this for a two-channel display, i.e. one display, one framebuffer,
 * but two LVDS channels, even pixels from one channel, odd pixels from the
 * other channel. Only define either DISPLAY_LVDS0 or DISPLAY_LVDS1 in this
 * case, using the full display resolution.
 */
//#define CONFIG_ARMSTONEA9_LVDS_SPLIT_MODE

/*
 * Define this if you have two similar displays (same resolution and timings),
 * one on each LVDS channel. The display content of the framebuffer is shown
 * on both displays simultaneously (cloned). Only define either DISPLAY_LVDS0
 * or DISPLAY_LVDS1 in this case, using the resolution of one of the displays.
 */
//#define CONFIG_ARMSTONEA9_LVDS_DUAL_MODE

/*
 * Configure touch screen:
 *
 * - 4-wire/5-wire analog resistive touch (SX8655), on RGB LCD adapter
 * - 4-wire/5-wire analog resistive touch (SX8655), on Touch Connector
 * - PCAP touch based on Maxtouch controller (MXT224, etc.), on Touch Connector
 * - PCAP touch based on Focaltech controller (FT5x06), on Touch Connector
 * - PCAP touch based on Sitronix controller (ST1633i), on Touch Connector
 * - PCAP touch based on Ilitek controller (ILI12xx), on Touch Connector
 *
 * Select none if you do not need touch support.
 */
#define CONFIG_ARMSTONEA9_4WTOUCH_SX8655_RGBADAPTER
//#define CONFIG_ARMSTONEA9_4WTOUCH_SX8655
//#define CONFIG_ARMSTONEA9_CAPTOUCH_MXT224
//#define CONFIG_ARMSTONEA9_CAPTOUCH_FT5x06
//#define CONFIG_ARMSTONEA9_CAPTOUCH_SITRONIX
//#define CONFIG_ARMSTONEA9_CAPTOUCH_ILITEK

/* CMA: Set 320 MB for Continuous Memory Allocator */
#define CONFIG_ARMSTONEA9_CMA_SIZE	0x14000000

/* NAND */
#define CONFIG_ARMSTONEA9_NAND

/* AUDIO */
#define CONFIG_ARMSTONEA9_SGTL5000_AUDIO

/* Use 12.288 MHz instead of 24.576 MHz for Audio */
//#define CONFIG_ARMSTONEA9_AUDIO_12M288

/* Camera on parallel CSI interface */
//#define CONFIG_ARMSTONEA9_PARALLEL_CAMERA

/* SD-CARD - SD_A is micro SD */
#define CONFIG_ARMSTONEA9_SD_A

/* PCIe */
/* On PCIe wire PCIECLKN/P there are some missing terminating resistor
 * therefore PCIe can´t get a link. These can be fixed if either the
 * corresponding adapter have these resistors or there must be a redesign
 * for armstone. The resistors can be found on efusA9.
 */
//#define CONFIG_ARMSTONEA9_PCIE

/* I2C (I2C_C breaks armStone standard and is disabled by default) */
#define CONFIG_ARMSTONEA9_I2C_A
#define CONFIG_ARMSTONEA9_I2C_B
//#define CONFIG_ARMSTONEA9_I2C_C

/* SPI */
#define CONFIG_ARMSTONEA9_SPI_A

/* UART */
#define CONFIG_ARMSTONEA9_UART_A
#define CONFIG_ARMSTONEA9_UART_A_RTSCTS
#define CONFIG_ARMSTONEA9_UART_B
#define CONFIG_ARMSTONEA9_UART_C

#include "imx6dl.dtsi"
#include "armstonea9qdl.dtsi"

/ {
	model = "F&S i.MX6 Solo/DualLite armStoneA9";
	compatible = "fsl,imx6dl-armstonea9", "fsl,imx6dl";
};

&bdinfo {
	board_name = "armstonea9dl";
};

/* i.MX6 Solo and DualLite have a PXP engine */
&pxp {
	status = "okay";
};
