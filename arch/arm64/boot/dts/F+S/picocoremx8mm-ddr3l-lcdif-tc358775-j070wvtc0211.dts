/*
 * Copyright (C) 2020 F&S Elektronik Systeme GmbH
 *
 * This program is free software; you can redistribute it and/or modify
 * it under the terms of the GNU General Public License version 2 as
 * published by the Free Software Foundation.
 */

#define CONFIG_PICOCOREMX8MX_MIPI_DSI_LVDS
#define CONFIG_IMX8MM_INVERTED_XY

#define IMX8MM_LVDS_RESET_GPIO_BANK		gpio1
#define IMX8MM_LVDS_RESET_GPIO_NUM		8
#define IMX8MM_LVDS_STBY_GPIO_BANK		gpio1
#define IMX8MM_LVDS_STBY_GPIO_NUM		4

#define IMX8MM_TOUCH_INTERRUPT_GPIO_BANK	gpio5
#define IMX8MM_TOUCH_INTERRUPT_GPIO_NUM		2

#define IMX8MM_TOUCH_RESET_GPIO_BANK gpio1
#define IMX8MM_TOUCH_RESET_GPIO_NUM 13

#define IMX8MM_TOUCH_I2C i2c2
#define IMX8MM_LVDS_I2C i2c1
#define IMX8MM_BACKLIGHT_PWM pwm2

#include "picocoremx8mm-ddr3l.dts"
#include "displays/imx8mm-lcdif-tc358775-j070wvtc0211.dtsi"

&touch {
		pinctrl-names = "default";
		pinctrl-0 = <&pinctrl_touch>;
};

&iomuxc {
	imx8mm-picocoremx8mx {
		pinctrl_touch: touch_grp {
			fsl,pins = <
				MX8MM_IOMUXC_GPIO1_IO13_GPIO1_IO13	0x00104
			>;
		};
	};
};





