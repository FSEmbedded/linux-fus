/*
* Copyright (C) 2024 F&S Elektronik Systeme GmbH
*
* This program is free software; you can redistribute it and/or modify
* it under the terms of the GNU General Public License version 2 as
* published by the Free Software Foundation.
*/

#define CONFIG_PICOCOREMX8ULP_MIPI_DSI
#define CONFIG_ADP_MIPI2MIPI1_BOARD_REVISION	120

#include "picocoremx8ulp.dts"
#include "displays/imx8ulp-lcdif-adp-mipi2mipi1-ee0350et-2cp.dtsi"