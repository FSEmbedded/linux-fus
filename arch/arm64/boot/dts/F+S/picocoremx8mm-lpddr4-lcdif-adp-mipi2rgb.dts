/*
 * Copyright (C) 2021 F&S Elektronik Systeme GmbH
 *
 * This program is free software; you can redistribute it and/or modify
 * it under the terms of the GNU General Public License version 2 as
 * published by the Free Software Foundation.
 */

#define CONFIG_PICOCOREMX8MM_MIPI_DSI

#define IMX8MM_I2C i2c2
#define IMX8MM_TOUCH_INTERRUPT_GPIO_BANK gpio1
#define IMX8MM_TOUCH_INTERRUPT_GPIO_NUM 0

#include "picocoremx8mm-lpddr4.dts"
#include "displays/imx8mm-lcdif-adp-mipi2rgb.dtsi"

