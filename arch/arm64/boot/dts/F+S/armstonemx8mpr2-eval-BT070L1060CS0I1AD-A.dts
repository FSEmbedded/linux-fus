/*
* Copyright (C) 2026 F&S Elektronik Systeme GmbH
*
* This program is free software; you can redistribute it and/or modify
* it under the terms of the GNU General Public License version 2 as
* published by the Free Software Foundation.
*/

/dts-v1/;

#define IMX8MP_TOUCH_I2C 				fs_i2c_b
#define IMX8MP_TOUCH_INTERRUPT_GPIO_BANK 		gpio1
#define IMX8MP_TOUCH_INTERRUPT_GPIO_NUM 		7
#define IMX8MP_LVDS_CHANNEL 1

#include "armstonemx8mpr2-eval.dts"
#include "displays/imx8mp-BT070L1060CS0I1AD-A.dtsi"
