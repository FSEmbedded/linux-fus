/*
* Copyright (C) 2019 F&S Elektronik Systeme GmbH
*
* This program is free software; you can redistribute it and/or modify
* it under the terms of the GNU General Public License version 2 as
* published by the Free Software Foundation.
*/

#define CONFIG_PICOCOREMX8MM_MIPI_DSI

#define IMX8MM_MIPI_RESET_GPIO_BANK	gpio1
#define IMX8MM_MIPI_RESET_GPIO_NUM	1

#include "picocoremx8mmr2-lpddr4.dts"
#include "displays/imx8mm-lcdif-g050tan01.dtsi"

