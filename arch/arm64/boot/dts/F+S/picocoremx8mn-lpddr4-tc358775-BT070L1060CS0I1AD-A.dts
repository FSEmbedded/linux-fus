/*
* Copyright (C) 2024 F&S Elektronik Systeme GmbH
*
* This program is free software; you can redistribute it and/or modify
* it under the terms of the GNU General Public License version 2 as
* published by the Free Software Foundation.
*/
#define CONFIG_PICOCOREMX8MN_MIPI_DSI_LVDS

#define IMX8MM_LVDS_RESET_GPIO_BANK		gpio4
#define IMX8MM_LVDS_RESET_GPIO_NUM		31

#define IMX8MM_TOUCH_INTERRUPT_GPIO_BANK	gpio1
#define IMX8MM_TOUCH_INTERRUPT_GPIO_NUM		0

#define IMX8MM_TOUCH_I2C i2c2
#define IMX8MM_LVDS_I2C i2c4

#include "picocoremx8mn-lpddr4.dts"
#include "displays/imx8mm-tc358775-BT070L1060CS0I1AD-A.dtsi"
