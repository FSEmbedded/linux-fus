/*
 * Copyright (C) 2024 F&S Elektronik Systeme GmbH
 *
 * This program is free software; you can redistribute it and/or modify
 * it under the terms of the GNU General Public License version 2 as
 * published by the Free Software Foundation.
 */
/dts-v1/;

#define CONFIG_SOLDERCORE8ULP_EMMC
#define CONFIG_SOLDERCORE8ULP_ETH_ADP
#define CONFIG_SOLDERCORE8ULP_UART
#define CONFIG_SOLDERCORE8ULP_USB0
#define CONFIG_SOLDERCORE8ULP_USB1
#define CONFIG_SOLDERCORE8ULP_EPDC
#define CONFIG_SOLDERCORE8ULP_MIPI_DSI

#include "fsimx8ulp.dtsi"

/ {
	model = "F&S SolderCore8ULP";
	compatible = "fus,soldercore8ulp", "fus,fsimx8ulp", "fsl,imx8ulp";
};

#include "displays/imx8ulp-lcdif-adp-mipi2mipi1-ee0350et-2cp.dtsi"