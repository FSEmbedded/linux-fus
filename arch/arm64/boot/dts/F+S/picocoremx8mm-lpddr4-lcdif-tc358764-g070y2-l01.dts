/*
* Copyright (C) 2019 F&S Elektronik Systeme GmbH
*
* This program is free software; you can redistribute it and/or modify
* it under the terms of the GNU General Public License version 2 as
* published by the Free Software Foundation.
*/

#define CONFIG_PICOCOREMX8MM_MIPI_DSI_LVDS

#define IMX8MM_LVDS_RESET_GPIO_BANK		gpio4
#define IMX8MM_LVDS_RESET_GPIO_NUM		31

#include "picocoremx8mm-lpddr4.dts"
#include "displays/imx8mm-lcdif-tc358764-g070y2-l01.dtsi"

