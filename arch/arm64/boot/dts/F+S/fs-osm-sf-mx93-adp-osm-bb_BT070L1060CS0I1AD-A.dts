// SPDX-License-Identifier: GPL-2.0
/*
* Copyright 2024 F&S Elektronik Systeme GmbH
*
* This program is free software; you can redistribute it and/or modify
* it under the terms of the GNU General Public License version 2 as
* published by the Free Software Foundation.
*
* This program is distributed in the hope that it will be useful,
* but WITHOUT ANY WARRANTY; without even the implied warranty of
* MERCHANTABILITY or FITNESS FOR A PARTICULAR PURPOSE.  See the
* GNU General Public License for more details.
*/

#define CONFIG_IMX93_DISPLAY

#include "fs-osm-sf-mx93-adp-osm-bb.dts"

reg_vlcd: &reg_disp_vdd_en {
    status = "okay";
};
IMX93_TOUCH_I2C: &osm_i2c_cam {};
#if ADP_OSM_BB_REV == 130
IMX93_TOUCH_INTERRUPT_GPIO_BANK: &gpio3 {};
#define IMX93_TOUCH_INTERRUPT_GPIO_NUM OSM_GPIO_A_0_PIN
#else
IMX93_TOUCH_INTERRUPT_GPIO_BANK: &gpio2 {};
#define IMX93_TOUCH_INTERRUPT_GPIO_NUM OSM_GPIO_A_3_PIN
#endif

#include "displays/imx93-BT070L1060CS0I1AD-A.dtsi"
