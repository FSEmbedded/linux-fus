/*
 * Copyright (C) 2019 F&S Elektronik Systeme GmbH
 *
 * This program is free software; you can redistribute it and/or modify
 * it under the terms of the GNU General Public License version 2 as
 * published by the Free Software Foundation.
 */

#define CONFIG_PICOCOREMX8MP_MIPI_DSI
#define CONFIG_PICOCOREMX8MP_INVERTED_XY
#include "picocoremx8mpr2.dts"
#include "displays/imx8mp-lcdif-adp-mipi2lvds1-j070wvtc0211-single-display.dtsi"
