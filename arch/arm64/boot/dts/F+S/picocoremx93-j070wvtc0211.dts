/*
 * Copyright (C) 2024 F&S Elektronik Systeme GmbH
 *
 * This program is free software; you can redistribute it and/or modify
 * it under the terms of the GNU General Public License version 2 as
 * published by the Free Software Foundation.
 */
//#define CONFIG_PICOCOREMX93_MIPI_DSI_LVDS
#define CONFIG_PICOCOREMX93_INVERTED_XY
#include "picocoremx93.dts"
#include "displays/imx93-j070wvtc0211.dtsi"
