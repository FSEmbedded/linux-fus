/*
* Copyright (C) 2024 F&S Elektronik Systeme GmbH
*
* This program is free software; you can redistribute it and/or modify
* it under the terms of the GNU General Public License version 2 as
* published by the Free Software Foundation.
*/

#include "picocoremx8ulp.dts"

#define CONFIG_PICOCOREMX8ULP_LVDS

#if defined(CONFIG_PICOCOREMX8ULP_MIPI_DSI) && defined(CONFIG_PICOCOREMX8ULP_LVDS)
#error "Set only on config at a time"
#endif

adp_i2c: &fs_i2c_b {};
reg_vlcd: &reg_vlcd_en {};


#include "displays/imx8ulp-adp-lvds2lvds1-BT070L1060CS0I1AD-A.dtsi"

&touch {
	interrupt-parent = <&rp_gpioa>;
	interrupts = <18 IRQ_TYPE_EDGE_FALLING>;
};
