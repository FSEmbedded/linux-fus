/*
 * Copyright (C) 2019 F&S Elektronik Systeme GmbH
 *
 * This program is free software; you can redistribute it and/or modify
 * it under the terms of the GNU General Public License version 2 as
 * published by the Free Software Foundation.
 */

/* LVDS Display */
#include "picocoremx8mpr2-lcdif-j070wvtc0211.dts"

/* MIPI Display */
//#include "picocoremx8mpr2-lcdif-adp-mipi2mipi1-ee0350et-2cp.dts"

/* MIPI-CSI Camera */
#include "picocoremx8mp-basler-isp.dtsi"
