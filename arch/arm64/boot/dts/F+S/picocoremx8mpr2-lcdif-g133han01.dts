/*
 * Copyright (C) 2021 F&S Elektronik Systeme GmbH
 *
 * This program is free software; you can redistribute it and/or modify
 * it under the terms of the GNU General Public License version 2 as
 * published by the Free Software Foundation.
 */

#define DISPLAY_NONE	0	/* No display on this port */
#define DISPLAY_HDMI	1	/* DVI/HDMI via HDMI connector */
#define DISPLAY_LVDS0	2	/* LVDS channel 0 - LVDSA on J9 */
#define DISPLAY_LVDS1	3	/* LVDS channel 1 - LVDSB on J9 */
#define DISPLAY_MIPI0	4	/* MIPI_DSI1 - LVDSA on J9 */
//#define DISPLAY_MIPI1	5	/* MIPI_DSI2 - not used */

/*
 * Set the display configuration:
 *
 * - If you have no display, set all three settings to DISPLAY_NONE.
 * - If you have one display, set PANEL0 to one of the display types above and
 *   leave the other settings at DISPLAY_NONE.
 * - If you have two displays, set PANEL0 and PANEL1 to a display type from
 *   above and leave PANEL2 at DISPLAY_NONE.
 * - If you have three displays, set all three settings to a display type.
 * - LVDS0 and MIPI0 at same time are not allowed. In case both are
 *   configured LVDS0 would be used and MIPI0 disabled.
 * - If dual mode is enabled LVDS1 would not used.
 *
 * You have to use a different type for each display. If you want two LVDS
 * displays, set one to DISPLAY_LVDS0 and the other to DISPLAY_LVDS1. This
 * corresponds to the LVDS channel where the display is connected to.
 *
 */
#define CONFIG_PICOCOREMX8MP_PANEL0	DISPLAY_LVDS1
#define CONFIG_PICOCOREMX8MP_PANEL1	DISPLAY_LVDS2
#define CONFIG_PICOCOREMX8MP_PANEL2	DISPLAY_NONE

/* Enables support for AUO G133HAN01.0 - 19:9 FHD, 1920(H)x1080(V) panel */
#define DISPLAY_LVDS_G133HAN010

/* The mode allows to use dual asynchronous channels (8 data, 2 clocks).
 * This is intended for single panel with 2 interfaces, transferring
 * across two channels (even pixel/odd pixel). This is supported at up to
 * 160MHz pixel clock, which is up to 80MHz LVDS clock.
 *  */
#define CONFIG_PICOCOREMX8MP_LVDS_DUAL_CHANNEL

#ifdef DISPLAY_LVDS_G133HAN010
#define CONFIG_PICOCOREMX8MP_LVDS0_CHANNEL_MAPPING	"jeida"
#define CONFIG_PICOCOREMX8MP_LVDS0_CHANNEL_DATA_WIDTH	24

#define CONFIG_PICOCOREMX8MP_LVDS0_PANEL_MAPPING	"jeida-24"
#define CONFIG_PICOCOREMX8MP_LVDS0_PANEL_LABEL	"g133han01"
#define CONFIG_PICOCOREMX8MP_LVDS0_PANEL_WIDTH	293
#define CONFIG_PICOCOREMX8MP_LVDS0_PANEL_HEIGHT	165
#define CONFIG_PICOCOREMX8MP_LVDS0_PANEL_TIMING \
	clock-frequency = <141200000>;	\
	hactive = <1920>;	\
	vactive = <1080>;	\
	hback-porch = <20>;	\
	hfront-porch = <159>;	\
	hsync-len = <70>;	\
	vback-porch = <37>;	\
	vfront-porch = <11>;	\
	vsync-len = <1>;	\
	pixelclk-active = <0>;
#endif

#include "picocoremx8mpr2.dts"
#include "displays/imx8mp-lcdif-g133han01.dtsi"
