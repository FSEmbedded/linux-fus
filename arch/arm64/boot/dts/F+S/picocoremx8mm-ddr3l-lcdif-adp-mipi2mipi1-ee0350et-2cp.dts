/*
* Copyright (C) 2019 F&S Elektronik Systeme GmbH
*
* This program is free software; you can redistribute it and/or modify
* it under the terms of the GNU General Public License version 2 as
* published by the Free Software Foundation.
*/

#define CONFIG_PICOCOREMX8MX_MIPI_DSI

#define IMX8MM_TOUCH_INTERRUPT_GPIO_BANK	gpio5
#define IMX8MM_TOUCH_INTERRUPT_GPIO_NUM		2

#define IMX8MM_TOUCH_I2C i2c2

#include "picocoremx8mm-ddr3l.dts"
#include "displays/imx8mm-lcdif-adp-mipi2mipi1-ee0350et-2cp.dtsi"

