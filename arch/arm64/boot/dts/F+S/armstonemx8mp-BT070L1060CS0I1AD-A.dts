/*
* Copyright (C) 2022 F&S Elektronik Systeme GmbH
*
* This program is free software; you can redistribute it and/or modify
* it under the terms of the GNU General Public License version 2 as
* published by the Free Software Foundation.
*/

/dts-v1/;

#define DISPLAY_NONE	0	/* No display on this port */
#define DISPLAY_HDMI	1	/* DVI/HDMI via HDMI connector */
#define DISPLAY_LVDS0	2	/* LVDS channel 0 - LVDSA on J9 */
#define DISPLAY_LVDS1	3	/* LVDS channel 1 - LVDSB on J9 */
#define DISPLAY_MIPI0	4	/* MIPI_DSI1 - LVDSA on J9 */
//#define DISPLAY_MIPI1	5	/* MIPI_DSI2 - not used */

/*
 * Set the display configuration:
 *
 * - If you have no display, set all three settings to DISPLAY_NONE.
 * - If you have one display, set PANEL0 to one of the display types above and
 *   leave the other settings at DISPLAY_NONE.
 * - If you have two displays, set PANEL0 and PANEL1 to a display type from
 *   above and leave PANEL2 at DISPLAY_NONE.
 * - If you have three displays, set all three settings to a display type.
 * - LVDS0 and MIPI0 at same time are not allowed. In case both are
 *   configured LVDS0 would be used and MIPI0 disabled.
 * - If dual mode is enabled LVDS1 would not used.
 *
 * You have to use a different type for each display. If you want two LVDS
 * displays, set one to DISPLAY_LVDS0 and the other to DISPLAY_LVDS1. This
 * corresponds to the LVDS channel where the display is connected to.
 *
 */
#define CONFIG_ARMSTONEMX8MP_PANEL0	DISPLAY_LVDS1
#define CONFIG_ARMSTONEMX8MP_PANEL1	DISPLAY_NONE
#define CONFIG_ARMSTONEMX8MP_PANEL2	DISPLAY_NONE

/*
 * F&S has changed the default LVDS display. To use the previous settings
 * activate the following define.
 */
#define DISPLAY_LVDS_BT070L1060CS0I1ADA

#include "armstonemx8mp.dts"


