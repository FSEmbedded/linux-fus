/*
 * Copyright (C) 2020 F&S Elektronik Systeme GmbH
 *
 * This program is free software; you can redistribute it and/or modify
 * it under the terms of the GNU General Public License version 2 as
 * published by the Free Software Foundation.
 */

#define CONFIG_PICOCOREMX8MM_MIPI_DSI_LVDS
#define CONFIG_IMX8MM_INVERTED_XY

#define IMX8MM_LVDS_RESET_GPIO_BANK		gpio4
#define IMX8MM_LVDS_RESET_GPIO_NUM		31

#define IMX8MM_TOUCH_INTERRUPT_GPIO_BANK	gpio1
#define IMX8MM_TOUCH_INTERRUPT_GPIO_NUM		0

#define IMX8MM_TOUCH_RESET_GPIO_BANK gpio1
#define IMX8MM_TOUCH_RESET_GPIO_NUM 13

#define IMX8MM_TOUCH_I2C i2c2
#define IMX8MM_BACKLIGHT_PWM pwm2

#include "picocoremx8mm-lpddr4.dts"
#include "displays/imx8mm-lcdif-tc358764-j070wvtc0211.dtsi"

