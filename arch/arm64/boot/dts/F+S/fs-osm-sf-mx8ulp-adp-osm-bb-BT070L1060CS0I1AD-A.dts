// SPDX-License-Identifier: GPL-2.0
/*
* Copyright 2024 F&S Elektronik Systeme GmbH
*
* This program is free software; you can redistribute it and/or modify
* it under the terms of the GNU General Public License version 2 as
* published by the Free Software Foundation.
*
* This program is distributed in the hope that it will be useful,
* but WITHOUT ANY WARRANTY; without even the implied warranty of
* MERCHANTABILITY or FITNESS FOR A PARTICULAR PURPOSE.  See the
* GNU General Public License for more details.
*/

#include "fs-osm-sf-mx8ulp-adp-osm-bb.dts"

adp_i2c: &osm_i2c_cam{};
reg_vlcd: &reg_disp_vdd_en{};

#include "displays/imx8ulp-adp-mipi2lvds1-BT070L1060CS0I1AD-A.dtsi"

&touch {
	interrupt-parent = <&rp_gpioc>;
	interrupts = <0 IRQ_TYPE_EDGE_RISING>;
};
