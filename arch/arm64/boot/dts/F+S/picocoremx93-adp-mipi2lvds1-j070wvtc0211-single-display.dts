/*
 * Copyright (C) 2019 F&S Elektronik Systeme GmbH
 *
 * This program is free software; you can redistribute it and/or modify
 * it under the terms of the GNU General Public License version 2 as
 * published by the Free Software Foundation.
 */

#define CONFIG_PICOCOREMX93_MIPI_DSI
#define CONFIG_PICOCOREMX93_INVERTED_XY
#include "picocoremx93.dts"
#include "displays/imx93-adp-mipi2lvds1-j070wvtc0211-single-display.dtsi"
