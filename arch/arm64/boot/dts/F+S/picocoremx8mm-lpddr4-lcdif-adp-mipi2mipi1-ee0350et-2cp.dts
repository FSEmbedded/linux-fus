#define CONFIG_PICOCOREMX8MM_MIPI_DSI

#define IMX8MM_TOUCH_INTERRUPT_GPIO_BANK	gpio1
#define IMX8MM_TOUCH_INTERRUPT_GPIO_NUM		0

#define IMX8MM_TOUCH_I2C i2c2

#include "picocoremx8mm-lpddr4.dts"
#include "displays/imx8mm-lcdif-adp-mipi2mipi1-ee0350et-2cp.dtsi"
