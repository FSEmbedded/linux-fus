/*
 * Copyright (C) 2021 F&S Elektronik Systeme GmbH
 *
 * This program is free software; you can redistribute it and/or modify
 * it under the terms of the GNU General Public License version 2 as
 * published by the Free Software Foundation.
 */

#define IMX8MP_TOUCH_I2C 				i2c4
#define IMX8MP_TOUCH_INTERRUPT_GPIO_BANK 		gpio1
#define IMX8MP_TOUCH_INTERRUPT_GPIO_NUM 		13
#define IMX8MP_LVDS_CHANNEL 1

#include "picocoremx8mpr2-BBDSI.dts"
#include "displays/imx8mp-BT070L1060CS0I1AD-A.dtsi"
