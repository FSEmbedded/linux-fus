/*
 * Copyright (C) 2021 F&S Elektronik Systeme GmbH
 *
 * This program is free software; you can redistribute it and/or modify
 * it under the terms of the GNU General Public License version 2 as
 * published by the Free Software Foundation.
 */
#define CONFIG_PICOCOREMX8MP_MIPI_DSI_LVDS
#define CONFIG_PICOCOREMX8MP_INVERTED_XY
/* TODO: does not work */
//#define CONFIG_PICOCOREMX8MP_LDB_DUAL_CHANNEL
#include "picocoremx8mpr2.dts"
#include "displays/imx8mp-lcdif-j070wvtc0211.dtsi"
