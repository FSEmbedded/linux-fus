/*
 * Copyright (C) 2019 F&S Elektronik Systeme GmbH
 *
 * This program is free software; you can redistribute it and/or modify
 * it under the terms of the GNU General Public License version 2 as
 * published by the Free Software Foundation.
 */

/dts-v1/;

#include "picocoremx8mm.dts"

/ {
	model = "F&S PicoCoreBBDSI";
};

&ecspi1 {

	can0: can@0 {
		compatible = "microchip,mcp2515";
		reg = <0>;
		clocks = <&mcp2515_clk>;
		interrupt-parent = <&gpio1>;
		interrupts = <9 IRQ_TYPE_EDGE_FALLING>;
		spi-max-frequency = <10000000>;
        mcp2515_clk: oscillator {
			#clock-cells = <0>;
            compatible = "fixed-clock";
            clock-frequency = <20000000>; //20MHz
		};  
	};

};
