// SPDX-License-Identifier: (GPL-2.0+ OR MIT)
/*
 * Copyright 2024 NXP
 */

&dpmac15 {
	phys = <&serdes_2_lane_e>;
	phy-names = "serdes";
	managed = "c73";
};

&pcs_mdio15 {
	status = "okay";
};

&serdes_2 {
	status = "okay";
};
