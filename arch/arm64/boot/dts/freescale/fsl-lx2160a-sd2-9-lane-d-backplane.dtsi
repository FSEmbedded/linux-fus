// SPDX-License-Identifier: (GPL-2.0+ OR MIT)
/*
 * Copyright 2024 NXP
 */

&dpmac18 {
	phys = <&serdes_2_lane_d>;
	phy-names = "serdes";
	managed = "c73";
};

&pcs_mdio18 {
	status = "okay";
};

&serdes_2 {
	status = "okay";
};
