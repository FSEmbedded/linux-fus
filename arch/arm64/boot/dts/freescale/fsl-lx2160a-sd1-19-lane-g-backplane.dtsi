// SPDX-License-Identifier: (GPL-2.0+ OR MIT)
/*
 * Copyright 2023 NXP
 */

&dpmac4 {
	phys = <&serdes_1_lane_g>;
	phy-names = "serdes";
	managed = "c73";
};

&pcs_mdio4 {
	status = "okay";
};

&serdes_1 {
	status = "okay";
};
