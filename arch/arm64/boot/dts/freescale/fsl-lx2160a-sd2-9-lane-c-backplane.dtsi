// SPDX-License-Identifier: (GPL-2.0+ OR MIT)
/*
 * Copyright 2024 NXP
 */

&dpmac17 {
	phys = <&serdes_2_lane_c>;
	phy-names = "serdes";
	managed = "c73";
};

&pcs_mdio17 {
	status = "okay";
};

&serdes_2 {
	status = "okay";
};
