// SPDX-License-Identifier: (GPL-2.0+ OR MIT)
/*
 * Copyright 2023 NXP
 */

&serdes_1 {
	status = "okay";
};

&dpmac2 {
	num-lanes = <4>;
	phys = <&serdes_1_lane_d>,
	       <&serdes_1_lane_c>,
	       <&serdes_1_lane_b>,
	       <&serdes_1_lane_a>;
	phy-names = "serdes0", "serdes1", "serdes2", "serdes3";
	managed = "c73";
};

&pcs_mdio2 {
	status = "okay";
};

&serdes_1 {
	status = "okay";
};
