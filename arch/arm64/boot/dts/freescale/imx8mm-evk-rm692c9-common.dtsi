// SPDX-License-Identifier: GPL-2.0+
/*
 * Copyright 2025 NXP
 */

&adv_bridge {
	status = "disabled";
};

&mipi_dsi {
	panel@0 {
		compatible = "raydium,rm692c9";
		reg = <0>;
		pinctrl-0 = <&pinctrl_mipi_dsi_en>;
		reset-gpio = <&gpio1 8 GPIO_ACTIVE_LOW>;
		dsi-lanes = <4>;
	};
};
