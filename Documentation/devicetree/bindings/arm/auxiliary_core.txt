## Documentation/devicetree/bindings/input/touchscreen/tsc2005.txt
```
* Texas Instruments tsc2004 and tsc2005 touchscreen controllers

Required properties:
 - compatible		      : "ti,tsc2004" or "ti,tsc2005"
 - reg			      : Device address
 - interrupts		      : IRQ specifier
 - spi-max-frequency	      : Maximum SPI clocking speed of the device
			        (for tsc2005)

Optional properties:
 - vio-supply		      : Regulator specifier
 - reset-gpios		      : GPIO specifier for the controller reset line
 - ti,x-plate-ohms	      : integer, resistance of the touchscreen's X plates
				in ohm (defaults to 280)
 - ti,esd-recovery-timeout-ms : integer, if the touchscreen does not respond after
				the configured time (in milli seconds), the driver
				will reset it. This is disabled by default.
 - ti,pre-charge-time         : integer, precharge time selection:
                                0: 20 µs
                                1: 84 µs
                                2: 276 µs (default)
                                3: 340 µs
                                4: 1.044 ms
                                5: 1.108 ms
                                6: 1.300 ms
                                7: 1.364 ms
 - ti,sense-time-sel          : integer, sense time selection:
                                0: 32 µs (default)
                                1: 96 µs
                                2: 544 µs
                                3: 608 µs
                                4: 2.080 ms
                                5: 2.144 ms
                                6: 2.592 ms
                                7: 2.656 ms
 - properties defined in touchscreen.txt

Example:

&i2c3 {
	tsc2004@48 {
		compatible = "ti,tsc2004";
		reg = <0x48>;
		vio-supply = <&vio>;

		reset-gpios = <&gpio4 8 GPIO_ACTIVE_HIGH>;
		interrupts-extended = <&gpio1 27 IRQ_TYPE_EDGE_RISING>;

		touchscreen-fuzz-x = <4>;
		touchscreen-fuzz-y = <7>;
		touchscreen-fuzz-pressure = <2>;
		touchscreen-size-x = <4096>;
		touchscreen-size-y = <4096>;
		touchscreen-max-pressure = <2048>;

		ti,x-plate-ohms = <280>;
		ti,esd-recovery-timeout-ms = <8000>;
	};
}

&mcspi1 {
	tsc2005@0 {
		compatible = "ti,tsc2005";
		spi-max-frequency = <6000000>;
		reg = <0>;

		vio-supply = <&vio>;

		reset-gpios = <&gpio4 8 GPIO_ACTIVE_HIGH>; /* 104 */
		interrupts-extended = <&gpio4 4 IRQ_TYPE_EDGE_RISING>; /* 100 */

		touchscreen-fuzz-x = <4>;
		touchscreen-fuzz-y = <7>;
		touchscreen-fuzz-pressure = <2>;
		touchscreen-size-x = <4096>;
		touchscreen-size-y = <4096>;
		touchscreen-max-pressure = <2048>;

		ti,x-plate-ohms = <280>;
		ti,esd-recovery-timeout-ms = <8000>;
	};
}
```

## Documentation/devicetree/bindings/media/lirc-gpioblaster.txt
```
Device-Tree bindings for lirc-gpioblaster

Required properties:
	- compatible: should be "lirc-gpioblaster".
	- gpios: specifies GPIO used for IR signal reception.

Optional properties:
	- softcarrier: If you want to modulate the output signal with 38 kHz.

Example node:

	lirc_gpioblaster {
		compatible = "lirc-gpioblaster";
		gpios = <&gpio1 20 0>;
		softcarrier;
		pinctrl-names = "default";
		pinctrl-0 = <&pinctrl_lirc_blaster>;
	};
```

## Documentation/devicetree/bindings/mfd/tps65185.txt
```
TPS65185 PMIC for Electrophoretic Displays

Required properties:
- compatible: "ti, tps65185"
- reg: i2c slave address
- regulators: This is the list of child nodes that specify the regulator
  initialization data for defined regulators. Not all regulators for the
  given device need to be present. The definition for each of these nodes
  is defined using the standard binding for regulators found at
  Documentation/devicetree/bindings/regulator/regulator.txt.
  The regulator is matched with the regulator-compatible.
- GPIO: The PMIC requires defined GPIO signals for WakeUp, PowerUp and Powergood.
  See the example below for the property-definition.

The valid regulator-compatible values are:
  tps65185: vdisp_reg, vpos_reg, vneg_reg, vgl_reg, vcom_reg, v3p3_reg

Example:
&epdc {
	pinctrl-names = "default";
	pinctrl-0 = <&pinctrl_epdc0>;
	DISPLAY-supply = <&vdisp_reg>;
	V3P3-supply = <&v3p3_reg>;
	VCOM-supply = <&vcom_reg>;
	VPOS-supply = <&vpos_reg>;
	VNEG-supply = <&vneg_reg>;
	status = "okay";
};

&lpi2c7 {
	tps65185: tps65185@68 {
		compatible = "ti,tps65185";
		reg = <0x68>;
		status = "okay";

		pinctrl-names = "default";
		pinctrl-0 = <&pinctrl_tps65185>;
		gpio-pmic-pwrgood = <&gpioe 17 GPIO_ACTIVE_HIGH>;
		gpio-pmic-wakeup = <&gpioe 18 GPIO_ACTIVE_HIGH>;
		gpio-pmic-pwrup = <&gpioe 22 GPIO_ACTIVE_HIGH>;

		regulators {
			vdisp_reg: DISPLAY {
				regulator-name = "DISPLAY";
			};

			vpos_reg: VPOS-LDO {
				regulator-name = "VPOS";
				regulator-min-microvolt = <7040000>;
				regulator-max-microvolt = <15060000>;
			};

			vneg_reg: VNEG-LDO {
				regulator-name = "VNEG";
				regulator-min-microvolt = <7040000>;
				regulator-max-microvolt = <15060000>;
			};

			vgl_reg: VGL-CHARGE-PUMP {
				regulator-name = "VGL";
			};

			vcom_reg: VCOM {
				regulator-name = "VCOM";
				regulator-min-microvolt = <19608>;
				regulator-max-microvolt = <5000000>;
			};

			v3p3_reg: V3P3 {
				regulator-name = "V3P3";
			};
		};
	};
};
```

## Documentation/devicetree/bindings/net/dsa/ksz.txt
```
Microchip KSZ Series Ethernet switches
==================================

Required properties:

- compatible: For external switch chips, compatible string must be exactly one
  of the following:
  - "microchip,ksz8765"
  - "microchip,ksz8794"
  - "microchip,ksz8795"
  - "microchip,ksz9477"
  - "microchip,ksz9897"
  - "microchip,ksz9896"
  - "microchip,ksz9567"
  - "microchip,ksz8565"
  - "microchip,ksz9893"
  - "microchip,ksz9563"
  - "microchip,ksz8563"

Optional properties:

- reset-gpios		: Should be a gpio specifier for a reset line
- microchip,synclko-125 : Set if the output SYNCLKO frequency should be set to
			  125MHz instead of 25MHz.
- xmii-mac-mode		: Set XMII-MAC-MODE (only verified for KSZ9893).
               		  MII interface: 0 = MII interfaces operates as PHY device
               		                 1 = MII interfaces operates as MAC device
               		  RMII interface: 0 = A 50 MHz RMII REFCLK is generated
               		                      from the RXC pin
               		                  1 = The 50 MHz RMII REFCLK is received
               		                      at the RXC pin
               		  RGMII interface: 0 = In-Band status disabled
               		                   1 = In-Band Status enabled
- led-gpio-phy-link	: Set if LEDX_Y should act as a GPIO and gets triggered if
               		  phy link state changes (only verified for KSZ9893).
               		  0 = LEDX_0 is setup as phy-link
               		  1 = LEDX_1 is setup as phy-link

See Documentation/devicetree/bindings/net/dsa/dsa.txt for a list of additional
required and optional properties.

Examples:

Ethernet switch connected via SPI to the host, CPU port wired to eth0:

	eth0: ethernet@10001000 {
		fixed-link {
			speed = <1000>;
			full-duplex;
		};
	};

	spi1: spi@f8008000 {
		pinctrl-0 = <&pinctrl_spi_ksz>;
		cs-gpios = <&pioC 25 0>;
		id = <1>;

		ksz9477: ksz9477@0 {
			compatible = "microchip,ksz9477";
			reg = <0>;

			spi-max-frequency = <44000000>;
			spi-cpha;
			spi-cpol;

			ports {
				#address-cells = <1>;
				#size-cells = <0>;
				port@0 {
					reg = <0>;
					label = "lan1";
				};
				port@1 {
					reg = <1>;
					label = "lan2";
				};
				port@2 {
					reg = <2>;
					label = "lan3";
				};
				port@3 {
					reg = <3>;
					label = "lan4";
				};
				port@4 {
					reg = <4>;
					label = "lan5";
				};
				port@5 {
					reg = <5>;
					label = "cpu";
					ethernet = <&eth0>;
					fixed-link {
						speed = <1000>;
						full-duplex;
					};
				};
			};
		};
		ksz8565: ksz8565@0 {
			compatible = "microchip,ksz8565";
			reg = <0>;

			spi-max-frequency = <44000000>;
			spi-cpha;
			spi-cpol;

			ports {
				#address-cells = <1>;
				#size-cells = <0>;
				port@0 {
					reg = <0>;
					label = "lan1";
				};
				port@1 {
					reg = <1>;
					label = "lan2";
				};
				port@2 {
					reg = <2>;
					label = "lan3";
				};
				port@3 {
					reg = <3>;
					label = "lan4";
				};
				port@6 {
					reg = <6>;
					label = "cpu";
					ethernet = <&eth0>;
					fixed-link {
						speed = <1000>;
						full-duplex;
					};
				};
			};
		};
	};
```

## Documentation/devicetree/bindings/net/natsemi-dp83848.txt
```
Natsemi DP83848 Ethernet PHY

DP83848:

  Optional properties:

    - dp83848,no-led-activity : Disable LED Activity. If not set, Activity will be enabled.
    - dp83848,auto-mdix : Enable Auto-MDIX. If not set, HW option will be used.

Examples:

	mdio {
		phy0: ethernet-phy@0 {
			compatible = "ethernet-phy-ieee802.3-c22";
			reg = <0>;
			dp83848,led-activity;
			dp83848,auto-mdix;
		};
	};
	ethernet@70000 {
		status = "okay";
		phy = <&phy0>;
		phy-mode = "rgmii-id";
	};
```

## Documentation/devicetree/bindings/net/realtek-rtl821x.txt
```
Realtek RTL821x Gigabit Ethernet PHY

RTL8211F:

  Spread-Spectrum clocking can be used by setting the optional flags
  in the Device-Tree. Additionally a LED can be configured for link
  indication and activity. HW default is used if those are not
  specified.

  Optional properties:

    - rtl821x,clkout-disable : Disable CLKOUT
    - rtl821x,aldps-enable : Enable Automatic Link Down Power Saving Mode
    - rtl821x,ssc-rxc-enable : Spread-Spectrum Clocking for RXC
    - rtl821x,ssc-sysclk-enable : Spread-Spectrum Clocking for SYSCLK
    - rtl821x,ssc-clkout-enable : Spread-Spectrum Clocking for CLKOUT
    - rtl821x,led-link : LED used for link indication
    - rtl821x,led-act : LED used for activity
    - rtl821x,gbit-disable : Disable 1000Mbps

Examples:

	mdio {
		phy0: ethernet-phy@0 {
			compatible = "ethernet-phy-ieee802.3-c22";
			reg = <0>;
			rtl821x,ssc-rxc-enable;
			rtl821x,ssc-sysclk-enable;
			rtl821x,ssc-clkout-enable;
			rtl821x,led-link = <1>; // LED1 for link indication
			rtl821x,led-act = <0>; // LED0 for activity
		};
	};
	ethernet@70000 {
		status = "okay";
		phy = <&phy0>;
		phy-mode = "rgmii-id";
	};
```

## Documentation/devicetree/bindings/net/realtek.txt
```
Realtek PHY properties.

These properties cover the base properties Realtek PHYs.

Optional properties:
 - rtl821x,clkout_en : enable clkout to supply clocks for MAC without ssc.
 - rtl821x,enable-clkout-ssc : enable spread spectrum clocking and clock on clkout.
 - rtl821x,enable-sysclk-ssc : enable spread spectrum clocking on system clock.
 - rtl821x,enable-rxc-ssc : enable spread spectrum clocking on rxc.
 - rtl821x,led-cnfg-mode-b : enable led coniguration mode B
   LED0 = not used
   LED1 = BLINK for Activity (10/100/1000)
   LED2 = ON for good Link (10/100/1000)
```

## Documentation/devicetree/bindings/net/ti-wl12xx.txt
```
Device-Tree bindings for TI WL12xx Chip

Required properties:
- compatible : can be "ti,wl1271", "ti,wl1273", "ti,wl1281", "ti,wl1283".
- reg : Should be <X>, according to which registers within the silicon block
        the device uses.
- interrupts : <a> where a is the interrupt number for the port.
- interrupt-parent : the phandle for the interrupt controller that services
		     interrupts for this device.
- ref-clock-frequency: The clock reference frequency of the chip in Hz.

example:
	wlcore: wlcore@2 {
		compatible = "ti,wl1271";
		reg = <2>;
		interrupt-parent = <&gpio3>;
		interrupts = <28 IRQ_TYPE_LEVEL_HIGH>; /* gpio 92 */
		ref-clock-frequency = <38400000>;
	};
```

## Documentation/devicetree/bindings/phy/fsl,lynx-10g.yaml
```yaml
# SPDX-License-Identifier: (GPL-2.0-only OR BSD-2-Clause)
%YAML 1.2
---
$id: http://devicetree.org/schemas/phy/fsl,lynx-10g.yaml#
$schema: http://devicetree.org/meta-schemas/core.yaml#

title: Freescale Lynx 10G SerDes PHY

description:
  The Lynx 10G is a multi-protocol SerDes block which handles networking, PCIe,
  SATA and other high-speed interfaces. It is present on most QorIQ and
  Layerscape SoCs. The integration is SoC-specific, with the differences
  consisting in register endianness, the number of lanes, protocol converters
  available per lane and their location in the PCCR registers. Some SoCs have
  multiple SerDes blocks and those differ in their protocol capabilities per
  lane.

maintainers:
  - Vladimir Oltean <vladimir.oltean@nxp.com>

properties:
  compatible:
    enum:
      - fsl,ls1028a-serdes
      - fsl,ls1046a-serdes1
      - fsl,ls1046a-serdes2
      - fsl,ls1088a-serdes1
      - fsl,ls2088a-serdes1
      - fsl,ls2088a-serdes2

  reg:
    maxItems: 1

  big-endian: true

  "#address-cells":
    const: 1
    description: Address cells for child lane nodes

  "#size-cells":
    const: 0
    description: Size cells for child lane nodes

patternProperties:
  "^phy@[0-9a-f]+$":
    type: object
    description: Individual SerDes lane acting as PHY provider

    properties:
      reg:
        description: |
          Lane logical number (lane A corresponds to 0). This number
          corresponds to the lane as visible in the SerDes IP's registers
          (such as LNaPSSR0), and this may not be necessarily identical to
          the lane numbering scheme from the SoC's pinout.
        maxItems: 1

      "#phy-cells":
        description: Number of cells in PHY specifier for this lane
        const: 0

    required:
      - reg
      - "#phy-cells"

    additionalProperties: false

required:
  - compatible
  - reg
  - "#address-cells"
  - "#size-cells"

additionalProperties: false

examples:
  - |
    soc {
      #address-cells = <2>;
      #size-cells = <2>;

      serdes_1: serdes@1ea0000 {
        compatible = "fsl,ls1028a-serdes";
        reg = <0x0 0x1ea0000 0x0 0xffff>;
        #address-cells = <1>;
        #size-cells = <0>;

        phy@0 {
          reg = <0>;
          #phy-cells = <0>;
        };

        phy@1 {
          reg = <1>;
          #phy-cells = <0>;
        };

        phy@2 {
          reg = <2>;
          #phy-cells = <0>;
        };

        phy@3 {
          reg = <3>;
          #phy-cells = <0>;
        };
      };
    };
```

## Documentation/devicetree/bindings/rpmsg/fsl,imx6sx-rpmsg.txt
```
Freescale i.MX6 SoloX RPMsg Node

Required properties:
- compatible : should be : "fsl,imx6sx-rpmsg"

Optional properties:
- vring-buffer-address0 : start adresse for the first ring buffer, should be
			  0x9FFF0000 (RAM 512 MB) or 0xBFFF0000
			  (RAM >= 1024 MB)
- vring-buffer-address1 : start adresse for the second ring buffer, should be
			  0x9FFF0000 (RAM 512 MB) or 0xBFFF0000
			  (RAM >= 1024 MB)

Example:

&rpmsg {
    compatible = "fsl,imx6sx-rpmsg";
    vring-buffer-address0 = <0x9FFF0000>;
    vring-buffer-address1 = <0x9FFF8000>;
  };
```

## Documentation/devicetree/bindings/sound/mt8183-mt6358-ts3a227-max98357.txt
```
MT8183 with MT6358, TS3A227, MAX98357, and RT1015 CODECS

Required properties:
- compatible : "mediatek,mt8183_mt6358_ts3a227_max98357"
- mediatek,platform: the phandle of MT8183 ASoC platform

Optional properties:
- mediatek,headset-codec: the phandles of ts3a227 codecs

Example:

	sound {
		compatible = "mediatek,mt8183_mt6358_ts3a227_max98357";
		mediatek,headset-codec = <&ts3a227>;
		mediatek,ec-codec = <&ec_codec>;
		mediatek,hdmi-codec = <&it6505dptx>;
		mediatek,platform = <&afe>;
	};
```
