## Documentation/devicetree/bindings/arm/auxiliary_core.txt
```
Auxiliary Core
=================

Required properties:

 - compatible: must be "auxiliaray-core"
 - clocks:     clock for the auxiliary core


Example:
/ {
	...
	...
	...

	/* F&S auxiliary core driver */
	auxiliary_core {
		compatible = "auxiliary-core";
		clocks = <&clks IMX6SX_CLK_M4>;
	};
};
```

## Documentation/devicetree/bindings/ax88796.txt
```
* ASIX AX88796 Ethernet Controller

Required properties:
- compatible : Should be "asix,ax88796-eth"
- reg :        Address and length of the register set for the device
- interrupts : Should contain fec interrupt
- rcr_val:     Set value RXCR for struct ei_device.
- dcr_val:     Set value for Data Configuration Register 0x0 byte-wide
               transfer, 0x1 word-wide transfer.
- wordlength:  Set the register access length. 1 is 8 bit, 2 is 16 bit.

Optional properties:
- gpoc_val:    Set Back-pressure Jam Limit Count (BJLC) default is 0x19.
- flags:       Flags can be: has-eeprom, mac-from-dev, has-93cx6.

Example:

	ax88796: ax88796 {
		compatible = "asix,ax88796-eth";
		reg = <1 0 0x40>;
		reset-supply = <&reg_ax88796>;
		pme-supply = <&reg_ax88796_pme>;
		pinctrl-names = "default";
		pinctrl-0 = <&pinctrl_ax88796>;
		interrupt-parent = <&gpio3>;
		interrupts = <14 IRQ_TYPE_EDGE_FALLING>;
		rcr_val = <0x40>;
		dcr_val = <0x1>;
		gpoc_val = <0x19>;
		wordlength = <2>;
		mac-from-dev;

		fsl,weim-cs-timing = <0x00020001 0x00000000 0x16000202
					0x00000002 0x16002082 0x00000000>;
	};
```

## Documentation/devicetree/bindings/display/bridge/lontium,lt9211.txt
```
LT9211 MIPI-DSI to RGB panel bridge

Required properties:
  - compatible: "lontium,lt9211"
  - reg: the virtual channel number of a DSI peripheral
  - vdd-supply: core voltage supply, 1.8V
  - vcc-supply: I/O voltage supply, 3.3V
  - reset-gpios: a GPIO spec for the reset pin
  - rx-source: Input signal 0 = LVDS, 1 = MIPI, 2 = TTL

Optional properites:
  - bus-fmt: overwrite Simple Panel setup: 6 = RGB666, 8 = RGB888
  - pclk-invert: invert dotclock polarity
  - lt,debug-pattern: using debug pattern as output to test display


The device node can contain following 'port' child nodes,
according to the OF graph bindings defined in [1]:
  0: DSI Input, not required, if the bridge is DSI controlled
  1: RGB Output, mandatory

[1]: Documentation/devicetree/bindings/media/video-interfaces.txt

Example:
    	/* mipi to RGB controller  */
	bridge@2d {
		reg = <0x2d>;
		compatible = "lontium,lt9211";
		vdd-supply = <&reg_vref_1v8>;
		vcc-supply = <&reg_vref_3v3>;
		reset-gpios = <&pca963x 3 GPIO_ACTIVE_HIGH>;
		/* 0 = LVDS, 1 = MIPI, 2 = TTL */
		rx-source = /bits/ 8 <1>;
		/* optional: normally taken from simple panel display but can
		 * be overwritten by bus-fmt flag: 6 = RGB666, 8 = RGB888
		 */
		bus-fmt = /bits/ 8 <8>;
		/* PCLK will inverted because dotclock polarity from
		 * sec_mipi_dsim-imx is set to neg edge. The display needs
		 * dotclock pos edge therefore we inverte dotclock polarity.
		 */
		pclk-invert;
//		lt,debug-pattern;
		#address-cells = <1>;
		#size-cells = <0>;
		ports {
			#address-cells = <1>;
			#size-cells = <0>;

			port@0 {
				reg = <0>;

				rgb_from_dsim: endpoint {
					remote-endpoint = <&dsim_to_rgb>;
				};
			};

			port@1 {
				reg = <1>;

				rgb_to_panel: endpoint {
					remote-endpoint = <&panel_from_rgb>;
				};
			};
		};
    };
```

## Documentation/devicetree/bindings/display/panel/simple-panel.txt
```
See panel-common.yaml in this directory.

Additional setting from F&S. Its possible to setup display parameters directly
in device tree without re-compiling kernel source. Therefore you need a
specific compatible string and the required parameters.

Required properties:
compatible:      "fus,disp-template" use this compatible string to setup own
                 timings for display.
refresh-rate:    refresh-rate in Hz
bits-per-color:  bits per color
bus-flags:       DRM bus flags (include/drm/drm_connector.h)
bus-format:      Media bus format (include/uapi/linux/media-bus-format.h)
panel-width-mm:  panel width in mm
panel-height-mm: panel height in mm
display-timings: Documentation/devicetree/bindings/display/panel/display-timing.txt

panel: panel {
        compatible = "fus,disp-template";
        backlight = <&backlight_lcd>;
        power-supply = <&reg_vlcd>;

        /* refresh-rate in Hz */
        refresh-rate = <60>;
        /* bits per color */
        bits-per-color = <6>;
        /* DRM_BUS_FLAG_DE_HIGH | DRM_BUS_FLAG_PIXDATA_DRIVE_NEGEDGE */
        bus-flags = <9>;
        /* MEDIA_BUS_FMT_RGB666_1X18 */
        bus-format = <0x100e>;
        panel-width-mm = <152>;
        panel-height-mm = <91>;
        display-timings {
                native-mode = <&timing0>;
                timing0: et070080 {
                        clock-frequency = <33260000>;
                        hactive = <800>;
                        vactive = <480>;
                        hfront-porch = <40>;
                        hsync-len = <128>;
                        hback-porch = <88>;
                        vfront-porch = <10>;
                        vsync-len = <2>;
                        vback-porch = <33>;
                        /* active high - positive edge */
                        de-active = <1>;
                        /* active low - negative edge */
                        vsync-active = <0>;
                        hsync-active = <0>;
                };
        };
};
```

## Documentation/devicetree/bindings/display/tc358762.txt
```
CMOS Digital Integrated Circout Silicon Monolithic TC358762
------------------------------------------------------------

The TC358762 is a de-serializer chip. The serial data stream is supplied by the
baseband prcoessor via the DSI 1.01 interface. TC358762 chip de-serializes the
stream into a parallel one. The parallel output bus can be either a DPI or a
DBI bus. The usage of either DPI or DBI bus is mutually exclusive.

Required properties:

- compatible: 		Should be one "toshiba,tc358762"
- reg: 			I2C slave address
- ref-clk:		Clock of external Oszilator
- dsi-traffic-mode:	0 = Non Burst with Sync Pulse, 1 = Non Burst with Sync
			Event, 2 = Burst Mode
- bpp:			bits per pixel 24 = RGB888, 18 = RGB666, 16 = RGB565
- tlpx:			time low power transmitter, get this information from
			your MIPI-DSI Peripherie (reference manual)
-ths-prepare:		high-speed prepare timer, get this information from
			your MIPI-DSI Peripherie (reference manual)
-ths-zero:		high-speed zero timer, get this information from
			your MIPI-DSI Peripherie (reference manual)
- display:		phandle to display node (see below for details)

Optional properties:

- data-lanes-num: 	Number of data lanes from MIPI Perihperie.
- reset-gpio:		reset gpio

Required nodes:

The TC358762 has a video port. The connection is modelled using the OF
graph bindings specified in Documentation/devicetree/bindings/graph.txt.

- Video port 0 for the RGB, YUV or DSI input. The remote endpoint phandle
  should be a reference to a valid mipi_dsi_host device node.


Example
-------

	tc358762: tc358762@0b {
		compatible = "toshiba,tc358762";
		reg = <0x0b>;
		ref-clk = <24000>;
		dsi-traffic-mode = <0>;
		bpp = <24>;
		tlpx = <50>;
		ths-prepare = <75>;
		ths-zero = <124>;

		display = <&display0>;
		status = "okay";

		port {
			dsi_to_rgb: endpoint {
				remote-endpoint = <&mipi_dsi_ep>;
			};
		};
	};

	&mipi_dsi_host {
		status = "okay";

		port {
			mipi_dsi_ep: endpoint {
				remote-endpoint = <&dsi_to_rgb>;
			};
		};
	};
```

## Documentation/devicetree/bindings/hwmon/ads1118.txt
```
ADS1118 (SPI)

The ADS1118 is 16-bit analog to digital converter with 4 inputs and a
temperature sensor.
The ADS1018 is a 12-bit version of the chip.

The inputs can be single ended or differential pair combinations.

Each channel, 0 - 4 may be configured as a single ended adc input.
Channel 0 may be configured differentially with channel 1.
Channels 0, 1, or 2 may be configured differentially with channel 3.

To set up a differential pair, the lower channel should be have
the ti,differential-endpoint property set to the higher channel in the pair.

Each channel can be configured individually:
 - fullscale voltage range values are +/- microvolts
    6144000, 4096000, 2048000, 1024000, 512000, or 256000

 - data_rate in samples per second
    - for the ads1018:
      128, 250, 490, 920, 1600, 2400, or 3300
    - for the ads1118:
      8, 16, 32, 64, 128, 250, or 860

The sensor contains an internal pullup register to keep the data output
high when not in use. This may be disabled, but is enabled by default.

1) The /ads1118 node

  Required properties:

   - compatible : must be "ti,ads1018" or "ti,ads1118"
   - spi-cpha : spi phase set to 1 (spi polarity is 0)
   - reg : the spi chipselect address
   - #address-cells : must be <1>
   - #size-cells : must be <0>

  Optional properties:

   - ti,tempsensor: enable the temperature sensor
   - ti,pullup-disable: disable the internal pullup resistor

  The node contains child nodes for each channel that the platform uses.

2) channel nodes

  Required properties:

   - reg : the channel number (0, 1, 2, or 3)

  Optional properties:

   - ti,differential-endpoint: differential second endpoint.
   - ti,fullscale: fullscale range in +/- microvolts
   - ti,datarate : the converter data rate in samples / second

  Example ADS1118 node:

	ads1118@0 {
		compatible = "ti,ads1118";
		spi-max-frequency = <2450000>;
		reg = <0>;
		#address-cells = <1>;
		#size-cells = <0>;
		ti,tempsensor;
		voltage0@0 {
			reg = <0>;
			ti,fullscale = <6144000>;
			ti,datarate = <860>;
			ti,differential-endpoint = <1>;
		};
		voltage1@3 {
			reg = <3>;
			ti,fullscale = <6144000>;
			ti,datarate = <475>;
		};
	};

For the above example, The temperature sensor is enabled as well as
channels 0 and 1 in differential mode, and channel 3 single ended.
```

## Documentation/devicetree/bindings/iio/temperature/bme280.txt
```
* Bosch bme280 digital humidity, pressure and temperature sensor

Required properties:
  - compatible: Should be "st,bme280-humid"
  - reg: Should contain the ADC I2C address

Optional properties:
  - temperature_oversampling: set the temperature oversampling rate. The rate
    can be 0, 1, 2, 4, 8, 16
  - pressure_oversampling: set the pressure oversampling rate. The rate
    can be 0, 1, 2, 4, 8, 16
  - humidity_oversampling: set the humidity oversampling rate. The rate
    can be 0, 1, 2, 4, 8, 16
  - t_standby: controls inactive duration in normal mode. The time can be
    1, 63, 125, 250, 500, 1000, 2000, 4000 ms
  - filter: controls the time constant of the IIR filter. the filter value can
    be 0 (filter off), 2, 4, 8, 16

    All values which differ from the values above will be rounded to one of
    them.

Example:
i2c4: 	bme280@76 {
		compatible = "st,bme280-humid";
		reg = <0x76>;
		temperature_oversampling = <4>;
		pressure_oversampling = <2>;
		humidity_oversampling = <1>;
		t_standby = <30>;
		filter = <0>;
	};
```

## Documentation/devicetree/bindings/iio/temperature/hts221.txt
```
* STMicroelectronics HTS221 capacitive digital sensor for relative humidity and temperature

Required properties:
  - compatible: Should be "st,hts221-humid"
  - reg: Should contain the ADC I2C address

Optional properties:
  - poll_interval: Set the polling interval. It can be 1 Hz, 7 Hz or 12.5 Hz
    every other value will be parsed to one of these frequences. Value is given
    in msec, so 1 Hz = 1000 ms
  - h_resolution: Select the numbers of averaged humidity samples. The Values
    can be 4, 8, 16, 32, 64, 128, 256, 512. The higher the value, the higher
    the accuracy but the higher the current too.
  - t_resolution: Select the numbers of averaged temperature samples. The Values
    can be 2, 4, 8, 16, 32, 64, 128, 256. The higher the value, the higher
    the accuracy but the higher the current too.

Example:
i2c4: hts221@5f {
		compatible = "st,hts221-humid";
		reg = <0x5f>;
		poll_interval = <100>;
		h_resolution = <32>;
		t_resolution = <16>;
	};
```

## Documentation/devicetree/bindings/input/touchscreen/esmt.txt
```
ESMT pcaptouch driver
=====================================

Required properties:

 - compatible:  "esmt_ts"

 - reg:         	I2C slave address of the chip (0x5d)
 - interrupt-parent: 	a phandle pointing to the interrupt controller
			serving the interrupt for this chip
 - interrupts:       	interrupt specification for the touchdetect
			interrupt

Optional properties:

 -touchscreen-size-x:	allows setting touchscreen size x.

 -touchscreen-size-y:	allows setting touchscreen size y.

 - touch_num:   	allows setting the number of touch point in the range
			from 0 to 10.

 - swap-xy:     	allows switching the x and y coordinates.

 - x-rev:		allows reverse the x coordinate.

 - y-rev:		allows reverse the y coordinate.

 - reset-gpios: 	GPIO specification for the RESET input.

Example:
	esmt@5d {
		compatible = "esmt_ts";
		reg = <0x5d>;
		touchscreen-size-x = <1280>;
		touchscreen-size-y = <800>;
		touch_num = <10>;
		swap-xy;
		interrupt-parent = <&gpio1>;
		interrupts = <30 IRQ_TYPE_EDGE_FALLING>;
	};
```

## Documentation/devicetree/bindings/input/touchscreen/sitronix-st1633i.txt
```
SITRONIX st1633i pcaptouch driver
=====================================

Required properties:

 - compatible:  "sitronix"

 - reg:         	I2C slave address of the chip (0x55)
 - interrupt-parent: 	a phandle pointing to the interrupt controller
			serving the interrupt for this chip
 - interrupts:       	interrupt specification for the touchdetect
			interrupt
 - reset-gpio: 		GPIO specification for the RESET input.

Optional properties:

 - swap-xy:     	allows switching the x and y coordinates.

 - x-rev:		allows reverse the x coordinate.

 - y-rev:		allows reverse the y coordinate.

Example:
	st1633i@55 {
		compatible = "sitronix";
		reg = <0x55>;
		swap-xy;
		interrupt-parent = <&gpio1>;
		interrupts = <30 IRQ_TYPE_EDGE_FALLING>;
		reset-gpio = <&gpio1 29 GPIO_ACTIVE_LOW>;
	};
```
