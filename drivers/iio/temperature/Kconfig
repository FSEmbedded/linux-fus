## drivers/iio/temperature/Kconfig
```kconfig
#
# Temperature sensor drivers
#
menu "Temperature sensors"

config MLX90614
	tristate "MLX90614 contact-less infrared sensor"
	depends on I2C
	help
	  If you say yes here you get support for the Melexis
	  MLX90614 contact-less infrared sensor connected with I2C.

	  This driver can also be built as a module. If so, the module will
	  be called mlx90614.

config TMP006
	tristate "TMP006 infrared thermopile sensor"
	depends on I2C
	help
	  If you say yes here you get support for the Texas Instruments
	  TMP006 infrared thermopile sensor.

	  This driver can also be built as a module. If so, the module will
	  be called tmp006.

config BME280
	tristate "Bosch BME280 tristate digital humidity, pressure and temperature"
	depends on I2C
	help
	  If you say yes here you get support for the Bosch BME280 digital
	  humidity, pressure and temperature.

	  This driver can also be built as a module. If so, the module will
	  be called BME280.
endmenu
```

## drivers/rpmsg/Kconfig
```kconfig
menu "Rpmsg drivers"

# RPMSG always gets selected by whoever wants it
config RPMSG
	tristate

config RPMSG_QCOM_SMD
	tristate "Qualcomm Shared Memory Driver (SMD)"
	depends on QCOM_SMEM
	depends on QCOM_SMD=n
	select RPMSG
	help
	  Say y here to enable support for the Qualcomm Shared Memory Driver
	  providing communication channels to remote processors in Qualcomm
	  platforms.

config RPMSG_VIRTIO
	tristate
	select RPMSG
	select VIRTIO
	select VIRTUALIZATION

config HAVE_IMX_RPMSG
	bool "IMX RPMSG driver on the AMP SOCs"
	select RPMSG
	select RPMSG_VIRTIO

config IMX_RPMSG_PINGPONG
	tristate "IMX RPMSG pingpong driver -- loadable modules only"
	default m
	depends on RPMSG && m

config IMX_RPMSG_TTY
	tristate "IMX RPMSG tty driver -- loadable modules only"
	default m
	depends on RPMSG && m

config FS_RPMSG
  bool "Driver for the Cortex-M4 demo 'fs_adc_i2c_rpmsg_demo'"
  default n
  depends on RPMSG
	help
    This driver provides an interface under /sys/imx_rpmsg to retrieve
    the values send by the fs_adc_i2c_rpmsg_demo from the Cortex-M4

endmenu
```

## drivers/vfio/pci/Kconfig
```kconfig
# SPDX-License-Identifier: GPL-2.0-only
config VFIO_PCI
	tristate "VFIO support for PCI devices"
	depends on VFIO && PCI && EVENTFD
	depends on MMU
	select VFIO_VIRQFD
	select IRQ_BYPASS_MANAGER

config VFIO_PCI_MMAP
	def_bool y if !S390

config VFIO_PCI_INTX
	def_bool y if !S390

config VFIO_PCI
	tristate "Generic VFIO support for any PCI device"
	select VFIO_PCI_CORE
	help
	  Support for the generic PCI VFIO bus driver which can connect any
	  PCI device to the VFIO framework.

	  If you don't know what to do here, say N.

if VFIO_PCI
config VFIO_PCI_VGA
	bool "Generic VFIO PCI support for VGA devices"
	depends on X86 && VGA_ARB
	help
	  Support for VGA extension to VFIO PCI.  This exposes an additional
	  region on VGA devices for accessing legacy VGA addresses used by
	  BIOS and generic video drivers.

	  If you don't know what to do here, say N.

config VFIO_PCI_IGD
	bool "Generic VFIO PCI extensions for Intel graphics (GVT-d)"
	depends on X86
	default y
	help
	  Support for Intel IGD specific extensions to enable direct
	  assignment to virtual machines.  This includes exposing an IGD
	  specific firmware table and read-only copies of the host bridge
	  and LPC bridge config space.

	  To enable Intel IGD assignment through vfio-pci, say Y.

config VFIO_PCI_NVLINK2
	def_bool y
	depends on VFIO_PCI && PPC_POWERNV && SPAPR_TCE_IOMMU
	help
	  VFIO PCI support for P9 Witherspoon machine with NVIDIA V100 GPUs

config VFIO_PCI_ZDEV
	bool "VFIO PCI ZPCI device CLP support"
	depends on VFIO_PCI && S390
	default y
	help
	  Enabling this option exposes VFIO capabilities containing hardware
	  configuration for zPCI devices. This enables userspace (e.g. QEMU)
	  to supply proper configuration values instead of hard-coded defaults
	  for zPCI devices passed through via VFIO on s390.

	  Say Y here.
```
